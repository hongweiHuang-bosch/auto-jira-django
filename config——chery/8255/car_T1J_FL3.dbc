VERSION "FL_IC_CANFD"

NS_ :

BS_:

BU_: AVAS BBCM CMSM DVR EAMP EPC FLZCU ICC PCL PLG SBOX SCU

BO_ 1531 BMS_9: 32 FLZCU
 SG_ BMS_HvBattSoeActDisChaCyc : 23|16@0+ (0.1,0) [0|999.9] "kWh"  ICC
 SG_ BMS_HvBattSoeActReChaCyc : 39|16@0+ (0.1,0) [0|999.9] "kWh"  ICC
 SG_ BMS_HvBattRatedEnergy : 55|14@0+ (0.1,0) [0|999.9] "KW/h"  ICC
 SG_ BMS_HvBattRatedU : 71|14@0+ (0.1,0) [0|999.9] "V"  ICC
 SG_ BMS_HvBattTypeCode : 87|8@0+ (1,0) [0|255] ""  ICC
 SG_ BMS_HvBattManufcCode : 95|32@0+ (1,0) [0|4294967295] ""  ICC
 SG_ BMS_HvBattTempSensorTotalNum : 127|16@0+ (1,0) [0|65534] ""  ICC
 SG_ BMS_HvBattTempSensorTempMaxNum : 143|8@0+ (1,0) [1|250] ""  ICC
 SG_ BMS_HvBattTempSensorTempMinNum : 151|8@0+ (1,0) [1|250] ""  ICC
 SG_ BMS_HvBattTempMaxNum : 159|8@0+ (1,0) [1|250] ""  ICC
 SG_ BMS_HvBattTempMinNum : 167|8@0+ (1,0) [1|250] ""  ICC
 SG_ BMS_BattCellTotalNum : 175|16@0+ (1,0) [0|65531] ""  ICC
 SG_ BMS_HvBattVoltMaxNum : 191|8@0+ (1,0) [1|250] ""  ICC
 SG_ BMS_HvBattVoltMinNum : 199|8@0+ (1,0) [1|250] ""  ICC
 SG_ BMS_ActualSOCMin : 207|12@0+ (0.025,0) [0|100] "%"  ICC
 SG_ BMS_ActualSOCMax : 211|12@0+ (0.025,0) [0|100] "%"  ICC

BO_ 1560 NMm_ICC: 8 ICC
 SG_ srcNodeID_ICC : 7|8@0+ (1,0) [0|255] "" Vector__XXX
 SG_ RMR_ICC : 8|1@0+ (1,0) [0|1] "" Vector__XXX
 SG_ NMm_ICC_Reserved1 : 15|7@0+ (1,0) [0|127] "" Vector__XXX
 SG_ ICC_Wakeup_Poweron : 16|1@0+ (1,0) [0|1] "" Vector__XXX
 SG_ ICC_Wakeup_NM : 17|1@0+ (1,0) [0|1] "" Vector__XXX
 SG_ ICC_Wakeup_Diag : 18|1@0+ (1,0) [0|1] "" Vector__XXX
 SG_ ICC_Wakeup_PowerComfortable : 20|1@0+ (1,0) [0|1] "" Vector__XXX
 SG_ ICC_Wakeup_HUD : 23|1@0+ (1,0) [0|1] "" Vector__XXX
 SG_ ICC_Wakeup_EAMP : 24|1@0+ (1,0) [0|1] "" Vector__XXX
 SG_ ICC_Awake_Poweron : 40|1@0+ (1,0) [0|1] "" Vector__XXX
 SG_ ICC_Awake_NM : 41|1@0+ (1,0) [0|1] "" Vector__XXX
 SG_ ICC_Awake_Diag : 42|1@0+ (1,0) [0|1] "" Vector__XXX
 SG_ ICC_Awake_PowerComfortable : 45|1@0+ (1,0) [0|1] "" Vector__XXX
 SG_ ICC_Awake_SentinelMode : 46|1@0+ (1,0) [0|1] "" Vector__XXX
 SG_ ICC_Awake_PetMode : 47|1@0+ (1,0) [0|1] "" Vector__XXX
 SG_ ICC_Awake_HUD : 48|1@0+ (1,0) [0|1] "" Vector__XXX
 SG_ ICC_Awake_EAMP : 49|1@0+ (1,0) [0|1] "" Vector__XXX
 SG_ ICC_Awake_FreezerFunction : 50|1@0+ (1,0) [0|1] "" Vector__XXX
 SG_ ICC_Awake_PowerOffDelay : 51|1@0+ (1,0) [0|1] "" Vector__XXX
 SG_ ICC_Awake_VehLockDwnLoad_618h : 52|1@0+ (1,0) [0|1] "" Vector__XXX

BO_ 1672 Diag_SBOX_REQ: 64 ICC
 SG_ Diag_SBOX_REQ : 7|64@0+ (1,0) [0|1.84467440737096E+019] ""  SBOX

BO_ 1673 Diag_SBOX_RES: 64 SBOX
 SG_ Diag_SBOX_RES : 7|64@0+ (1,0) [0|1.84467440737096E+019] ""  ICC

BO_ 1674 Diag_ILCF_REQ: 64 ICC
 SG_ Diag_ILCF_REQ : 7|64@0+ (1,0) [0|1.84467440737096E+019] ""  FLZCU

BO_ 1675 Diag_ILCF_RES: 64 FLZCU
 SG_ Diag_ILCF_RES : 7|64@0+ (1,0) [0|1.84467440737096E+019] ""  ICC

BO_ 1676 Diag_BBCM_REQ: 64 ICC
 SG_ Diag_BBCM_REQ : 7|64@0+ (1,0) [0|1.84467440737096E+019] ""  BBCM

BO_ 1677 Diag_BBCM_RES: 64 BBCM
 SG_ Diag_BBCM_RES : 7|64@0+ (1,0) [0|1.84467440737096E+019] ""  ICC

BO_ 1678 Diag_CMSM_REQ: 64 ICC
 SG_ Diag_CMSM_REQ : 7|64@0+ (1,0) [0|1.84467440737096E+019] ""  CMSM

BO_ 1679 Diag_CMSM_RES: 64 CMSM
 SG_ Diag_CMSM_RES : 7|64@0+ (1,0) [0|1.84467440737096E+019] ""  ICC

BO_ 1680 Diag_FLCCP_REQ_CANFD: 64 ICC
 SG_ Diag_FLCCP_REQ : 7|64@0+ (1,0) [0|1.84467440737096E+019] ""  FLZCU

BO_ 1681 Diag_FLCCP_RES_CANFD: 64 FLZCU
 SG_ Diag_FLCCP_RES : 7|64@0+ (1,0) [0|1.84467440737096E+019] ""  ICC

BO_ 1692 Diag_FRCCP_REQ_CANFD: 64 ICC
 SG_ Diag_FRCCP_REQ : 7|64@0+ (1,0) [0|1.84467440737096E+019] ""  FLZCU

BO_ 1693 Diag_FRCCP_RES_CANFD: 64 FLZCU
 SG_ Diag_FRCCP_RES : 7|64@0+ (1,0) [0|1.84467440737096E+019] ""  ICC

BO_ 1694 Diag_ATCM_REQ_CANFD: 64 ICC
 SG_ Diag_ATCM_REQ : 7|64@0+ (1,0) [0|1.84467440737096E+019] ""  FLZCU

BO_ 1695 Diag_ATCM_RES_CANFD: 64 FLZCU
 SG_ Diag_ATCM_RES : 7|64@0+ (1,0) [0|1.84467440737096E+019] ""  ICC

BO_ 1696 Diag_DWDM_REQ_CANFD: 64 ICC
 SG_ Diag_DWDM_REQ : 7|64@0+ (1,0) [0|1.84467440737096E+019] ""  FLZCU

BO_ 1697 Diag_DWDM_RES_CANFD: 64 FLZCU
 SG_ Diag_DWDM_RES : 7|64@0+ (1,0) [0|1.84467440737096E+019] ""  ICC

BO_ 1698 Diag_UVC_REQ_CANFD: 64 ICC
 SG_ Diag_UVC_REQ : 7|64@0+ (1,0) [0|1.84467440737096E+019] ""  FLZCU

BO_ 1699 Diag_UVC_RES_CANFD: 64 FLZCU
 SG_ Diag_UVC_RES : 7|64@0+ (1,0) [0|1.84467440737096E+019] ""  ICC

BO_ 1702 Diag_APTC_REQ_CANFD: 64 ICC
 SG_ Diag_APTC_REQ : 7|64@0+ (1,0) [0|1.84467440737096E+019] ""  FLZCU

BO_ 1703 Diag_APTC_RES_CANFD: 64 FLZCU
 SG_ Diag_APTC_RES : 7|64@0+ (1,0) [0|1.84467440737096E+019] ""  ICC

BO_ 1704 Diag_ECALL_REQ_CANFD: 64 ICC
 SG_ Diag_ECALL_REQ : 7|64@0+ (1,0) [0|1.84467440737096E+019] ""  FLZCU

BO_ 1705 Diag_ECALL_RES_CANFD: 64 FLZCU
 SG_ Diag_ECALL_RES : 7|64@0+ (1,0) [0|1.84467440737096E+019] ""  ICC

BO_ 1706 Diag_PM25_REQ_CANFD: 64 ICC
 SG_ Diag_PM25_REQ : 7|64@0+ (1,0) [0|1.84467440737096E+019] ""  FLZCU

BO_ 1707 Diag_PM25_RES_CANFD: 64 FLZCU
 SG_ Diag_PM25_RES : 7|64@0+ (1,0) [0|1.84467440737096E+019] ""  ICC

BO_ 1708 Diag_TCU_REQ_CANFD: 64 ICC
 SG_ Diag_TCU_REQ : 7|64@0+ (1,0) [0|1.84467440737096E+019] ""  FLZCU

BO_ 1709 Diag_TCU_RES_CANFD: 64 FLZCU
 SG_ Diag_TCU_RES : 7|64@0+ (1,0) [0|1.84467440737096E+019] ""  ICC

BO_ 1720 Diag_EOP_REQ_CANFD: 64 ICC
 SG_ Diag_EOP_REQ : 7|64@0+ (1,0) [0|255] ""  FLZCU

BO_ 1721 Diag_EOP_RES_CANFD: 64 FLZCU
 SG_ Diag_EOP_RES : 7|64@0+ (1,0) [0|255] ""  ICC

BO_ 1750 Diag_AIPMR_REQ_CANFD: 64 ICC
 SG_ Diag_AIPMR_REQ : 7|64@0+ (1,0) [0|1.84467440737096E+019] ""  FLZCU

BO_ 1751 Diag_AIPMR_RES_CANFD: 64 FLZCU
 SG_ Diag_AIPMR_RES : 7|64@0+ (1,0) [0|1.84467440737096E+019] ""  ICC

BO_ 1794 Diag_IOC_REQ_CNANFD: 64 ICC
 SG_ Diag_IOC_REQ : 7|64@0+ (1,0) [0|1.84467440737096E+019] ""  FLZCU

BO_ 1800 Diag_RADAR_REQ_CANFD: 64 ICC
 SG_ Diag_RADAR_REQ : 7|64@0+ (1,0) [0|1.84467440737096E+019] ""  FLZCU

BO_ 1805 Diag_CWC_REQ: 64 ICC
 SG_ Diag_CWC_REQ : 7|64@0+ (1,0) [0|1.84467440737096E+019] ""  FLZCU

BO_ 1810 Diag_FMCU_REQ: 64 ICC
 SG_ Diag_FMCU_REQ : 7|64@0+ (1,0) [0|1.84467440737096E+019] ""  FLZCU

BO_ 1811 Diag_BMS_REQ: 64 ICC
 SG_ Diag_BMS_REQ : 7|64@0+ (1,0) [0|1.84467440737096E+019] ""  FLZCU

BO_ 1814 Diag_EAC_REQ: 64 ICC
 SG_ Diag_EAC_REQ : 7|64@0+ (1,0) [0|1.84467440737096E+019] ""  FLZCU

BO_ 1817 Diag_EPC_REQ: 64 ICC
 SG_ Diag_EPC_REQ : 7|64@0+ (1,0) [0|1.84467440737096E+019] ""  EPC

BO_ 1818 Diag_RMCU_REQ: 64 ICC
 SG_ Diag_RMCU_REQ : 7|64@0+ (1,0) [0|1.84467440737096E+019] ""  FLZCU

BO_ 1824 Diag_LISD_REQ: 64 ICC
 SG_ Diag_LISD_REQ : 7|64@0+ (1,0) [0|1.84467440737096E+019] ""  FLZCU

BO_ 1825 Diag_DCB_REQ: 64 ICC
 SG_ Diag_DCB_REQ : 7|64@0+ (1,0) [0|1.84467440737096E+019] ""  FLZCU

BO_ 1827 Diag_EPS_REQ: 64 ICC
 SG_ Diag_EPS_REQ : 7|64@0+ (1,0) [0|1.84467440737096E+019] ""  FLZCU

BO_ 1829 Diag_ICC_REQ: 64 FLZCU
 SG_ Diag_ICC_REQ : 7|64@0+ (1,0) [0|1.84467440737096E+019] ""  ICC

BO_ 1830 Diag_RISD_REQ: 64 ICC
 SG_ Diag_RISD_REQ : 7|64@0+ (1,0) [0|1.84467440737096E+019] ""  FLZCU

BO_ 1832 Diag_TBOX_REQ: 64 ICC
 SG_ Diag_TBOX_REQ : 7|64@0+ (1,0) [0|1.84467440737096E+019] ""  FLZCU

BO_ 1834 Diag_ONEBOX_REQ: 64 ICC
 SG_ Diag_ONEBOX_REQ_72Ah : 7|64@0+ (1,0) [0|1.84467440737096E+019] ""  FLZCU

BO_ 1835 Diag_ASU_REQ: 64 ICC
 SG_ Diag_ASU_REQ : 7|64@0+ (1,0) [0|1.84467440737096E+019] ""  FLZCU

BO_ 1838 Diag_PPMID_REQ_CANFD: 64 ICC
 SG_ Diag_PPMID_REQ : 7|64@0+ (1,0) [0|1.84467440737096E+019] ""  FLZCU

BO_ 1840 Diag_BNCM_REQ: 64 ICC
 SG_ Diag_BNCM_REQ : 7|64@0+ (1,0) [0|1.84467440737096E+019] ""  FLZCU

BO_ 1841 Diag_LC_REQ: 64 ICC
 SG_ Diag_LC_REQ : 7|64@0+ (1,0) [0|1.84467440737096E+019] ""  FLZCU

BO_ 1842 Diag_IPB2_REQ: 64 ICC
 SG_ Diag_IPB2_REQ : 7|64@0+ (1,0) [0|1.84467440737096E+019] "" Vector__XXX

BO_ 1843 Diag_TCUR_REQ: 64 ICC
 SG_ Diag_TCUR_REQ : 7|64@0+ (1,0) [0|1.84467440737096E+019] ""  FLZCU

BO_ 1844 Diag_FLZCU_REQ: 64 ICC
 SG_ Diag_FLZCU_REQ : 7|64@0+ (1,0) [0|1.84467440737096E+019] ""  FLZCU

BO_ 1845 Diag_FRZCU_REQ: 64 ICC
 SG_ Diag_FRZCU_REQ : 7|64@0+ (1,0) [0|1.84467440737096E+019] ""  FLZCU

BO_ 1847 Diag_ADCC_REQ_737h: 64 ICC
 SG_ Diag_ADCC_REQ_737h : 7|64@0+ (1,0) [0|1.84467440737096E+019] ""  FLZCU

BO_ 1848 Diag_LHM_REQ_738h: 64 ICC
 SG_ Diag_LHM_REQ_738h : 7|64@0+ (1,0) [0|1.84467440737096E+019] ""  FLZCU

BO_ 1849 Diag_RHM_REQ_739h: 64 ICC
 SG_ Diag_RHM_REQ_739h : 7|64@0+ (1,0) [0|1.84467440737096E+019] ""  FLZCU

BO_ 1851 Diag_TCM_REQ_CANFD: 64 ICC
 SG_ Diag_TCM_REQ : 7|64@0+ (1,0) [0|1.84467440737096E+019] ""  FLZCU

BO_ 1853 Diag_CDU_REQ: 64 ICC
 SG_ Diag_CDU_REQ : 7|64@0+ (1,0) [0|1.84467440737096E+019] ""  FLZCU

BO_ 1856 Diag_BSCU_REQ_CANFD: 64 ICC
 SG_ Diag_BSCU_REQ : 7|64@0+ (1,0) [0|1.84467440737096E+019] ""  FLZCU

BO_ 1857 Diag_FRM_REQ: 64 ICC
 SG_ Diag_FRM_REQ : 7|64@0+ (1,0) [0|1.84467440737096E+019] ""  FLZCU

BO_ 1858 Diag_FCM_REQ: 64 ICC
 SG_ Diag_FCM_REQ : 7|64@0+ (1,0) [0|1.84467440737096E+019] ""  FLZCU

BO_ 1859 Diag_RLCR_REQ: 64 ICC
 SG_ Diag_RLCR_REQ : 7|64@0+ (1,0) [0|1.84467440737096E+019] ""  FLZCU

BO_ 1860 Diag_RRCR_REQ: 64 ICC
 SG_ Diag_RRCR_REQ : 7|64@0+ (1,0) [0|1.84467440737096E+019] ""  FLZCU

BO_ 1862 Diag_SCU_REQ: 64 ICC
 SG_ Diag_SCU_REQ : 7|64@0+ (1,0) [0|1.84467440737096E+019] ""  SCU

BO_ 1868 Diag_FLCR_REQ: 64 ICC
 SG_ Diag_FLCR_REQ : 7|64@0+ (1,0) [0|1.84467440737096E+019] ""  FLZCU

BO_ 1869 Diag_FRCR_REQ: 64 ICC
 SG_ Diag_FRCR_REQ : 7|64@0+ (1,0) [0|1.84467440737096E+019] ""  FLZCU

BO_ 1871 Diag_EAMP_REQ: 64 ICC
 SG_ Diag_EAMP_REQ : 7|64@0+ (1,0) [0|1.84467440737096E+019] ""  EAMP

BO_ 1873 Diag_WPTC_REQ_CANFD: 64 ICC
 SG_ Diag_WPTC_REQ : 7|64@0+ (1,0) [0|1.84467440737096E+019] ""  FLZCU

BO_ 1875 Diag_EVCC_REQ: 64 ICC
 SG_ Diag_EVCC_REQ : 7|64@0+ (1,0) [0|1.84467440737096E+019] ""  FLZCU

BO_ 1877 Diag_MFS_REQ_CANFD: 64 ICC
 SG_ Diag_MFS_REQ : 7|64@0+ (1,0) [0|1.84467440737096E+019] ""  FLZCU

BO_ 1878 Diag_CWCR_REQ: 64 ICC
 SG_ Diag_CWCR_REQ : 7|64@0+ (1,0) [0|1.84467440737096E+019] ""  FLZCU

BO_ 1880 Diag_CSA_REQ: 64 ICC
 SG_ Diag_CSA_REQ : 7|64@0+ (1,0) [0|1.84467440737096E+019] ""  FLZCU

BO_ 1889 Diag_DDMA_REQ: 64 ICC
 SG_ Diag_DDMA_REQ : 7|64@0+ (1,0) [0|1.84467440737096E+019] ""  FLZCU

BO_ 1890 Diag_TAIM_REQ_CANFD: 64 ICC
 SG_ Diag_TAIM_REQ : 7|64@0+ (1,0) [0|1.84467440737096E+019] ""  FLZCU

BO_ 1891 Diag_AVAS_REQ: 64 ICC
 SG_ DIAG_AVAS_REQ : 7|64@0+ (1,0) [0|1.84467440737096E+019] ""  AVAS

BO_ 1894 Diag_CHB_REQ_CANFD: 64 ICC
 SG_ Diag_CHB_REQ : 7|64@0+ (1,0) [0|1.84467440737096E+019] ""  FLZCU

BO_ 1896 Diag_GLONASS_REQ_CANFD: 64 ICC
 SG_ Diag_GLONASS_REQ : 7|64@0+ (1,0) [0|1.84467440737096E+019] ""  FLZCU

BO_ 1897 Diag_DDMA_RES: 64 FLZCU
 SG_ Diag_DDMA_RES : 7|64@0+ (1,0) [0|1.84467440737096E+019] ""  ICC

BO_ 1898 Diag_TAIM_RES_CANFD: 64 FLZCU
 SG_ Diag_TAIM_RES : 7|64@0+ (1,0) [0|1.84467440737096E+019] ""  ICC

BO_ 1899 DIAG_AVAS_RES: 64 AVAS
 SG_ DIAG_AVAS_RES : 7|64@0+ (1,0) [0|1.84467440737096E+019] ""  ICC

BO_ 1900 Diag_PLG_REQ: 64 ICC
 SG_ Diag_PLG_REQ : 7|64@0+ (1,0) [0|1.84467440737096E+019] ""  PCL,PLG

BO_ 1902 Diag_CHB_RES_CANFD: 64 FLZCU
 SG_ Diag_CHB_RES : 7|64@0+ (1,0) [0|1.84467440737096E+019] ""  ICC

BO_ 1909 Diag_LBMS_REQ: 64 ICC
 SG_ Diag_LBMS_REQ : 7|64@0+ (1,0) [0|1.84467440737096E+019] ""  FLZCU

BO_ 1912 Diag_GLONASS_RES_CANFD: 64 FLZCU
 SG_ Diag_GLONASS_RES : 7|64@0+ (1,0) [0|1.84467440737096E+019] ""  ICC

BO_ 1916 Diag_PLG_RES: 64 PCL
 SG_ Diag_PLG_RES : 7|64@0+ (1,0) [0|1.84467440737096E+019] ""  ICC

BO_ 1917 Diag_LBMS_RES: 64 FLZCU
 SG_ Diag_LBMS_RES : 7|64@0+ (1,0) [0|1.84467440737096E+019] ""  ICC

BO_ 1922 Diag_IOC_RES_CANFD: 64 FLZCU
 SG_ Diag_IOC_RES : 7|64@0+ (1,0) [0|1.84467440737096E+019] ""  ICC

BO_ 1928 Diag_RADAR_RES_CANFD: 64 FLZCU
 SG_ Diag_RADAR_RES : 7|64@0+ (1,0) [0|1.84467440737096E+019] ""  ICC

BO_ 1933 Diag_CWC_RES: 64 FLZCU
 SG_ Diag_CWC_RES : 7|64@0+ (1,0) [0|1.84467440737096E+019] ""  ICC

BO_ 1938 Diag_FMCU_RES: 64 FLZCU
 SG_ Diag_FMCU_RES : 7|64@0+ (1,0) [0|1.84467440737096E+019] ""  ICC

BO_ 1939 Diag_BMS_RES: 64 FLZCU
 SG_ Diag_BMS_RES : 7|64@0+ (1,0) [0|1.84467440737096E+019] ""  ICC

BO_ 1942 Diag_EAC_RES: 64 FLZCU
 SG_ Diag_EAC_RES : 7|64@0+ (1,0) [0|1.84467440737096E+019] ""  ICC

BO_ 1945 Diag_EPC_RES: 64 EPC
 SG_ Diag_EPC_RES : 7|64@0+ (1,0) [0|1.84467440737096E+019] ""  ICC

BO_ 1946 Diag_RMCU_RES: 64 FLZCU
 SG_ Diag_RMCU_RES : 7|64@0+ (1,0) [0|1.84467440737096E+019] ""  ICC

BO_ 1952 Diag_LISD_RES: 64 FLZCU
 SG_ Diag_LISD_RES : 7|64@0+ (1,0) [0|1.84467440737096E+019] ""  ICC

BO_ 1953 Diag_DCB_RES: 64 FLZCU
 SG_ Diag_DCB_RES : 7|64@0+ (1,0) [0|1.84467440737096E+019] ""  ICC

BO_ 1955 Diag_EPS_RES: 64 FLZCU
 SG_ Diag_EPS_RES : 7|64@0+ (1,0) [0|1.84467440737096E+019] ""  ICC

BO_ 1957 Diag_ICC_RES: 64 ICC
 SG_ Diag_ICC_RES : 7|64@0+ (1,0) [0|1.84467440737096E+019] ""  FLZCU

BO_ 1958 Diag_RISD_RES: 64 FLZCU
 SG_ Diag_RISD_RES : 7|64@0+ (1,0) [0|1.84467440737096E+019] ""  ICC

BO_ 1960 Diag_TBOX_RES: 64 FLZCU
 SG_ Diag_TBOX_RES : 7|64@0+ (1,0) [0|1.84467440737096E+019] ""  ICC

BO_ 1962 Diag_ONEBOX_RES: 64 FLZCU
 SG_ Diag_ONEBOX_RES : 7|64@0+ (1,0) [0|1.84467440737096E+019] ""  ICC

BO_ 1963 Diag_ASU_RES: 64 FLZCU
 SG_ Diag_ASU_RES : 7|64@0+ (1,0) [0|1.84467440737096E+019] ""  ICC

BO_ 1966 Diag_PPMID_RES_CANFD: 64 FLZCU
 SG_ Diag_PPMID_RES : 7|64@0+ (1,0) [0|1.84467440737096E+019] ""  ICC

BO_ 1968 Diag_BNCM_RES: 64 FLZCU
 SG_ Diag_BNCM_RES : 7|64@0+ (1,0) [0|1.84467440737096E+019] ""  ICC

BO_ 1969 Diag_LC_RES: 64 FLZCU
 SG_ Diag_LC_RES : 7|64@0+ (1,0) [0|1.84467440737096E+019] ""  ICC

BO_ 1970 Diag_IPB2_RES: 64 FLZCU
 SG_ Diag_IPB2_RES : 7|64@0+ (1,0) [0|1.84467440737096E+019] ""  ICC

BO_ 1971 Diag_TCUR_RES: 64 FLZCU
 SG_ Diag_TCUR_RES : 7|64@0+ (1,0) [0|1.84467440737096E+019] ""  ICC

BO_ 1972 Diag_FLZCU_RES: 64 FLZCU
 SG_ Diag_FLZCU_RES : 7|64@0+ (1,0) [0|1.84467440737096E+019] ""  ICC

BO_ 1973 Diag_FRZCU_RES: 64 FLZCU
 SG_ Diag_FRZCU_RES : 7|64@0+ (1,0) [0|1.84467440737096E+019] ""  ICC

BO_ 1975 Diag_ADCC_RES_7B7h: 64 FLZCU
 SG_ Diag_ADCC_RES_7B7h : 7|64@0+ (1,0) [0|1.84467440737096E+019] ""  ICC

BO_ 1976 Diag_LHM_RES_7B8h: 64 FLZCU
 SG_ Diag_LHM_RES_7B8h : 7|64@0+ (1,0) [0|1.84467440737096E+019] ""  ICC

BO_ 1977 Diag_RHM_RES_7B9h: 64 FLZCU
 SG_ Diag_RHM_RES_7B9h : 7|64@0+ (1,0) [0|1.84467440737096E+019] ""  ICC

BO_ 1979 Diag_TCM_RES_CANFD: 64 FLZCU
 SG_ Diag_TCM_RES : 7|64@0+ (1,0) [0|1.84467440737096E+019] ""  ICC

BO_ 1981 Diag_CDU_RES: 64 FLZCU
 SG_ Diag_CDU_RES : 7|64@0+ (1,0) [0|1.84467440737096E+019] ""  ICC

BO_ 1984 Diag_BSCU_RES_CANFD: 64 FLZCU
 SG_ Diag_BSCU_RES : 7|64@0+ (1,0) [0|1.84467440737096E+019] ""  ICC

BO_ 1985 Diag_FRM_RES: 64 FLZCU
 SG_ Diag_FRM_RES : 7|64@0+ (1,0) [0|1.84467440737096E+019] ""  ICC

BO_ 1986 Diag_FCM_RES: 64 FLZCU
 SG_ Diag_FCM_RES : 7|64@0+ (1,0) [0|1.84467440737096E+019] ""  ICC

BO_ 1987 Diag_RLCR_RES: 64 FLZCU
 SG_ Diag_RLCR_RES : 7|64@0+ (1,0) [0|1.84467440737096E+019] ""  ICC

BO_ 1988 Diag_RRCR_RES: 64 FLZCU
 SG_ Diag_RRCR_RES : 7|64@0+ (1,0) [0|1.84467440737096E+019] ""  ICC

BO_ 1990 Diag_SCU_RES: 64 SCU
 SG_ Diag_SCU_RES : 7|64@0+ (1,0) [0|1.84467440737096E+019] ""  ICC

BO_ 1996 Diag_FLCR_RES: 64 FLZCU
 SG_ Diag_FLCR_RES : 7|64@0+ (1,0) [0|1.84467440737096E+019] ""  ICC

BO_ 1997 Diag_FRCR_RES: 64 FLZCU
 SG_ Diag_FRCR_RES : 7|64@0+ (1,0) [0|1.84467440737096E+019] ""  ICC

BO_ 1999 Diag_EAMP_RES: 64 EAMP
 SG_ Diag_EAMP_RES : 7|64@0+ (1,0) [0|1.84467440737096E+019] ""  ICC

BO_ 2001 Diag_WPTC_RES_CANFD: 64 FLZCU
 SG_ Diag_WPTC_RES : 7|64@0+ (1,0) [0|1.84467440737096E+019] ""  ICC

BO_ 2003 Diag_EVCC_RES: 64 FLZCU
 SG_ Diag_EVCC_RES : 7|64@0+ (1,0) [0|1.84467440737096E+019] ""  ICC

BO_ 2005 Diag_MFS_RES_CANFD: 64 FLZCU
 SG_ Diag_MFS_RES : 7|64@0+ (1,0) [0|1.84467440737096E+019] ""  ICC

BO_ 2006 Diag_CWCR_RES: 64 FLZCU
 SG_ Diag_CWCR_RES : 7|64@0+ (1,0) [0|1.84467440737096E+019] ""  ICC

BO_ 2008 Diag_CSA_RES: 64 FLZCU
 SG_ Diag_CSA_RES : 7|64@0+ (1,0) [0|1.84467440737096E+019] ""  ICC

BO_ 2015 DIAG_OBD_REQ_Broadcast: 64 ICC
 SG_ Diag_Functional_REQ : 7|64@0+ (1,0) [0|1.84467440737096E+019] ""  ICC

BO_ 2016 Diag_OBD_EMS_REQ: 64 ICC
 SG_ Diag_OBD_EMS_REQ : 7|64@0+ (1,0) [0|1.84467440737096E+019] ""  FLZCU

BO_ 2017 Diag_OBD_TCU_REQ: 64 ICC
 SG_ Diag_OBD_TCU_REQ : 7|64@0+ (1,0) [0|1.84467440737096E+019] ""  FLZCU

BO_ 2018 Diag_OBD_BMS_REQ: 64 ICC
 SG_ Diag_OBD_BMS_REQ : 7|64@0+ (1,0) [0|1.84467440737096E+019] ""  FLZCU

BO_ 2019 Diag_OBD_RMCU_REQ: 64 ICC
 SG_ Diag_OBD_RMCU_REQ : 7|64@0+ (1,0) [0|1.84467440737096E+019] ""  FLZCU

BO_ 2020 Diag_OBD_ISG_REQ: 64 ICC
 SG_ Diag_OBD_ISG_REQ : 7|64@0+ (1,0) [0|1.84467440737096E+019] ""  FLZCU

BO_ 2021 Diag_OBD_ONEBOX_REQ: 64 ICC
 SG_ Diag_ONEBOX_REQ : 7|64@0+ (1,0) [0|1.84467440737096E+019] ""  FLZCU

BO_ 2022 Diag_OBD_CDU_REQ: 64 ICC
 SG_ Diag_OBD_CDU_REQ : 7|64@0+ (1,0) [0|1.84467440737096E+019] ""  FLZCU

BO_ 2024 Diag_OBD_EMS_RES: 64 FLZCU
 SG_ Diag_OBD_EMS_RES : 7|64@0+ (1,0) [0|1.84467440737096E+019] ""  ICC

BO_ 2025 Diag_OBD_TCU_RES: 8 FLZCU
 SG_ Diag_OBD_TCU_RES : 7|64@0+ (1,0) [0|255] ""  ICC

BO_ 2026 Diag_OBD_BMS_RES: 8 FLZCU
 SG_ Diag_OBD_BMS_RES : 7|64@0+ (1,0) [0|255] ""  ICC

BO_ 2027 Diag_OBD_RMCU_RES: 8 FLZCU
 SG_ Diag_OBD_RMCU_RES : 7|64@0+ (1,0) [0|255] ""  ICC

BO_ 2028 Diag_OBD_ISG_RES: 8 FLZCU
 SG_ Diag_OBD_ISG_RES : 7|64@0+ (1,0) [0|255] ""  ICC

BO_ 2030 Diag_OBD_CDU_RES: 8 FLZCU
 SG_ Diag_OBD_CDU_RES : 7|64@0+ (1,0) [0|255] ""  ICC

BO_ 2033 Diag_ACU_REQ: 64 ICC
 SG_ Diag_ACU_REQ : 7|64@0+ (1,0) [0|1.84467440737096E+019] ""  FLZCU

BO_ 2041 Diag_ACU_RES: 64 FLZCU
 SG_ Diag_ACU_RES : 7|64@0+ (1,0) [0|1.84467440737096E+019] ""  ICC

BO_TX_BU_ 1916 : PCL,PLG;
CM_ SG_ 1531 BMS_HvBattSoeActDisChaCyc "一个驾驶循环内放电能量累计";
CM_ SG_ 1531 BMS_HvBattSoeActReChaCyc "一个驾驶循环内回充能量累计";
CM_ SG_ 1531 BMS_HvBattRatedEnergy "电池额定能量";
CM_ SG_ 1531 BMS_HvBattRatedU "电池额定电压";
CM_ SG_ 1531 BMS_HvBattTypeCode "发送动力电池类型";
CM_ SG_ 1531 BMS_HvBattManufcCode "供应商代码";
CM_ SG_ 1531 BMS_HvBattTempSensorTotalNum "电池模组温度传感器总个数";
CM_ SG_ 1531 BMS_HvBattTempSensorTempMaxNum "最高温度NTC所在的编号";
CM_ SG_ 1531 BMS_HvBattTempSensorTempMinNum "最低温度NTC所在的编号";
CM_ SG_ 1531 BMS_HvBattTempMaxNum "最高温度模组编号";
CM_ SG_ 1531 BMS_HvBattTempMinNum "最低温度模组编码编号";
CM_ SG_ 1531 BMS_BattCellTotalNum "电池电芯总个数";
CM_ SG_ 1531 BMS_HvBattVoltMaxNum "最高单体电压模组编号";
CM_ SG_ 1531 BMS_HvBattVoltMinNum "最低单体电压所在模组编号";
CM_ SG_ 1531 BMS_ActualSOCMin "映射显示SOC值";
CM_ SG_ 1531 BMS_ActualSOCMax "映射显示SOC值";
CM_ SG_ 1560 srcNodeID_ICC "The srcNodeID of IHU is 0x18";
CM_ SG_ 1560 RMR_ICC "If set to 1 to force the network management of all other nodes on the bus into the re-peat message state.";
CM_ SG_ 1560 ICC_Wakeup_Poweron "整车电源档位为on档（KL15硬线）";
CM_ SG_ 1560 ICC_Wakeup_NM "NM报文";
CM_ SG_ 1560 ICC_Wakeup_Diag "Wakeup Source3 Reserved";
CM_ SG_ 1560 ICC_Wakeup_PowerComfortable "整车电源档位为Comfortable档（KL15硬线）";
CM_ SG_ 1560 ICC_Wakeup_HUD "HUD唤醒（0x63E）股份信号，捷途预留";
CM_ SG_ 1560 ICC_Wakeup_EAMP "EAMP唤醒（0x62A）股份信号，捷途预留";
CM_ SG_ 1560 ICC_Awake_Poweron "整车电源档位为on档（KL15硬线）";
CM_ SG_ 1560 ICC_Awake_NM "Awake Reason2 Reserved";
CM_ SG_ 1560 ICC_Awake_Diag "接收到本部件相关的以太诊断报文";
CM_ SG_ 1560 ICC_Awake_PowerComfortable "整车电源档位为Comfortable档（KL15硬线）";
CM_ SG_ 1560 ICC_Awake_SentinelMode "哨兵模式激活（股份信号，捷途预留）";
CM_ SG_ 1560 ICC_Awake_PetMode "宠物模式";
CM_ SG_ 1560 ICC_Awake_HUD "HUD维持网络（超时2.5s)股份信号，捷途预留";
CM_ SG_ 1560 ICC_Awake_EAMP "EAMP维持网络（超时2.5s)股份信号，捷途预留";
CM_ SG_ 1560 ICC_Awake_FreezerFunction "冰箱功能激活（股份信号，捷途预留）";
CM_ SG_ 1560 ICC_Awake_PowerOffDelay "退电延迟功能激活";
CM_ SG_ 1560 ICC_Awake_VehLockDwnLoad_618h "OTA下载软件";
CM_ BO_ 1672 "8~64字节自适应";
CM_ BO_ 1673 "8~64字节自适应";
CM_ BO_ 1674 "8~64字节自适应";
CM_ BO_ 1675 "8~64字节自适应";
CM_ BO_ 1676 "8~64字节自适应";
CM_ BO_ 1677 "8~64字节自适应";
CM_ BO_ 1678 "8~64字节自适应";
CM_ BO_ 1679 "8~64字节自适应";
CM_ SG_ 1708 Diag_TCU_REQ "8~64字节自适应";
CM_ SG_ 1709 Diag_TCU_RES "8~64字节自适应";
CM_ BO_ 1805 "8~64字节自适应";
CM_ BO_ 1810 "8~64字节自适应";
CM_ BO_ 1811 "8~64字节自适应";
CM_ BO_ 1817 "8~64字节自适应";
CM_ BO_ 1818 "8~64字节自适应";
CM_ BO_ 1824 "8~64字节自适应";
CM_ BO_ 1825 "8~64字节自适应";
CM_ BO_ 1827 "8~64字节自适应";
CM_ BO_ 1829 "8~64字节自适应";
CM_ BO_ 1830 "8~64字节自适应";
CM_ BO_ 1832 "8~64字节自适应";
CM_ BO_ 1834 "8~64字节自适应";
CM_ BO_ 1835 "8~64字节自适应";
CM_ BO_ 1840 "8~64字节自适应";
CM_ BO_ 1841 "8~64字节自适应";
CM_ BO_ 1842 "8~64字节自适应";
CM_ BO_ 1843 "8~64字节自适应";
CM_ BO_ 1844 "8~64字节自适应";
CM_ BO_ 1845 "8~64字节自适应";
CM_ BO_ 1847 "8~64字节自适应";
CM_ BO_ 1848 "8~64字节自适应";
CM_ BO_ 1849 "8~64字节自适应";
CM_ BO_ 1853 "8~64字节自适应";
CM_ BO_ 1857 "8~64字节自适应";
CM_ BO_ 1858 "8~64字节自适应";
CM_ BO_ 1859 "8~64字节自适应";
CM_ BO_ 1860 "8~64字节自适应";
CM_ BO_ 1868 "8~64字节自适应";
CM_ BO_ 1869 "8~64字节自适应";
CM_ BO_ 1871 "8~64字节自适应";
CM_ BO_ 1875 "8~64字节自适应";
CM_ BO_ 1880 "8~64字节自适应";
CM_ SG_ 1891 DIAG_AVAS_REQ "8~64字节自适应
";
CM_ SG_ 1899 DIAG_AVAS_RES "8~64字节自适应";
CM_ BO_ 1900 "8~64字节自适应";
CM_ BO_ 1909 "8~64字节自适应";
CM_ BO_ 1916 "8~64字节自适应";
CM_ BO_ 1917 "8~64字节自适应";
CM_ BO_ 1933 "8~64字节自适应";
CM_ BO_ 1938 "8~64字节自适应";
CM_ BO_ 1939 "8~64字节自适应";
CM_ BO_ 1945 "8~64字节自适应";
CM_ BO_ 1946 "8~64字节自适应";
CM_ BO_ 1952 "8~64字节自适应";
CM_ BO_ 1953 "8~64字节自适应";
CM_ BO_ 1955 "8~64字节自适应";
CM_ BO_ 1957 "8~64字节自适应";
CM_ BO_ 1958 "8~64字节自适应";
CM_ BO_ 1960 "8~64字节自适应";
CM_ BO_ 1962 "8~64字节自适应";
CM_ BO_ 1963 "8~64字节自适应";
CM_ BO_ 1968 "8~64字节自适应";
CM_ BO_ 1969 "8~64字节自适应";
CM_ BO_ 1970 "8~64字节自适应";
CM_ BO_ 1971 "8~64字节自适应";
CM_ BO_ 1972 "8~64字节自适应";
CM_ BO_ 1973 "8~64字节自适应";
CM_ BO_ 1975 "8~64字节自适应";
CM_ BO_ 1976 "8~64字节自适应";
CM_ BO_ 1977 "8~64字节自适应";
CM_ BO_ 1981 "8~64字节自适应";
CM_ BO_ 1985 "8~64字节自适应";
CM_ BO_ 1986 "8~64字节自适应";
CM_ BO_ 1987 "8~64字节自适应";
CM_ BO_ 1988 "8~64字节自适应";
CM_ BO_ 1996 "8~64字节自适应";
CM_ BO_ 1997 "8~64字节自适应";
CM_ BO_ 1999 "8~64字节自适应";
CM_ BO_ 2003 "8~64字节自适应";
CM_ BO_ 2006 "8~64字节自适应";
CM_ BO_ 2008 "8~64字节自适应";
CM_ BO_ 2016 "8~64字节自适应";
CM_ SG_ 2016 Diag_OBD_EMS_REQ "UDS Msg Length为8~64Byte自适应
OBD Msg Length为8Byte";
CM_ BO_ 2017 "8~64Byte自适应";
CM_ SG_ 2017 Diag_OBD_TCU_REQ "8~64Byte自适应";
CM_ BO_ 2018 "8~64byte自适应";
CM_ SG_ 2018 Diag_OBD_BMS_REQ "控制器针对上位机的请求做8~64字节自适应";
CM_ BO_ 2019 "8~64Byte自适应";
CM_ SG_ 2019 Diag_OBD_RMCU_REQ "8~64Byte自适应";
CM_ BO_ 2020 "8~64Byte自适应";
CM_ SG_ 2020 Diag_OBD_ISG_REQ "8~64Byte自适应";
CM_ BO_ 2021 "8~64字节自适应";
CM_ BO_ 2022 "8~64byte自适应";
CM_ SG_ 2022 Diag_OBD_CDU_REQ "控制器针对上位机的请求做8~64字节自适应";
CM_ BO_ 2024 "8~64字节自适应";
CM_ SG_ 2024 Diag_OBD_EMS_RES "UDS Msg Length为8~64Byte自适应
OBD Msg Length为8Byte";
CM_ BO_ 2033 "8~64字节自适应";
CM_ BO_ 2041 "8~64字节自适应";
BA_DEF_ SG_  "ASIL" ENUM  "QM","A","B","C","D";
BA_DEF_ SG_  "E2EDataLength" INT 0 65535;
BA_DEF_ SG_  "GenSigInactiveValue" HEX 0 80000000;
BA_DEF_ SG_  "GenSigInvalidValue" HEX 0 281474976710655;
BA_DEF_ SG_  "GenSigStartValue" HEX 0 80000000;
BA_DEF_ SG_  "GenSigSendType" ENUM  "Cyclic","OnWrite","OnWriteWithRepetition","OnChange","OnChangeWithRepetition","IfActive","IfActiveWithRepetition","NoSigSendType";
BA_DEF_ BO_  "CANFD_BRS" ENUM  "0","1";
BA_DEF_ BO_  "DiagRequest" ENUM  "No","Yes";
BA_DEF_ BO_  "DiagResponse" ENUM  "No","Yes";
BA_DEF_ BO_  "DiagState" ENUM  "No","Yes";
BA_DEF_ BO_  "DiagUudtResponse" ENUM  "True","False";
BA_DEF_ BO_  "GenMsgCycleTime" INT 0 65535;
BA_DEF_ BO_  "GenMsgCycleTimeFast" INT 0 65535;
BA_DEF_ BO_  "GenMsgDelayTime" INT 0 65535;
BA_DEF_ BO_  "GenMsgILSupport" ENUM  "No","Yes";
BA_DEF_ BO_  "GenMsgNrOfRepetition" INT 0 255;
BA_DEF_ BO_  "GenMsgSendType" ENUM  "Cyclic","Event","IfActive","CE","CA","NoMsgSendType";
BA_DEF_ BO_  "MsgType" ENUM  "IL","NM","DIAG","APPL";
BA_DEF_ BO_  "NmAsrMessage" ENUM  "No","Yes";
BA_DEF_ BO_  "SCP_AuthInfoTxLength" INT 9 512;
BA_DEF_ BO_  "SCP_FreshnessValueLength" INT 0 512;
BA_DEF_ BO_  "SCP_FreshnessValueTxLength" INT 0 512;
BA_DEF_ BO_  "VFrameFormat" ENUM  "StandardCAN","ExtendedCAN","reserved","J1939PG","reserved","reserved","reserved","reserved","reserved","reserved","reserved","reserved","reserved","reserved","StandardCAN_FD","ExtendedCAN_FD";
BA_DEF_DEF_  "ASIL" "QM";
BA_DEF_DEF_  "E2EDataLength" 64;
BA_DEF_DEF_  "GenSigInactiveValue" 0;
BA_DEF_DEF_  "GenSigInvalidValue" 0;
BA_DEF_DEF_  "GenSigStartValue" 0;
BA_DEF_DEF_  "GenSigSendType" "NoSigSendType";
BA_DEF_DEF_  "CANFD_BRS" "1";
BA_DEF_DEF_  "DiagRequest" "No";
BA_DEF_DEF_  "DiagResponse" "No";
BA_DEF_DEF_  "DiagState" "No";
BA_DEF_DEF_  "DiagUudtResponse" "True";
BA_DEF_DEF_  "GenMsgCycleTime" 0;
BA_DEF_DEF_  "GenMsgCycleTimeFast" 0;
BA_DEF_DEF_  "GenMsgDelayTime" 0;
BA_DEF_DEF_  "GenMsgILSupport" "Yes";
BA_DEF_DEF_  "GenMsgNrOfRepetition" 0;
BA_DEF_DEF_  "GenMsgSendType" "Cyclic";
BA_DEF_DEF_  "MsgType" "IL";
BA_DEF_DEF_  "NmAsrMessage" "No";
BA_DEF_DEF_  "SCP_AuthInfoTxLength" 28;
BA_DEF_DEF_  "SCP_FreshnessValueLength" 48;
BA_DEF_DEF_  "SCP_FreshnessValueTxLength" 4;
BA_DEF_DEF_  "VFrameFormat" "J1939PG";
BA_ "GenMsgCycleTime" BO_ 1531 1000;
BA_ "VFrameFormat" BO_ 1531 14;
BA_ "VFrameFormat" BO_ 1560 0;
BA_ "NmAsrMessage" BO_ 1560 1;
BA_ "MsgType" BO_ 1560 1;
BA_ "GenMsgCycleTime" BO_ 1560 1000;
BA_ "GenMsgSendType" BO_ 1672 1;
BA_ "DiagUudtResponse" BO_ 1672 1;
BA_ "MsgType" BO_ 1672 2;
BA_ "DiagRequest" BO_ 1672 1;
BA_ "VFrameFormat" BO_ 1672 14;
BA_ "GenMsgSendType" BO_ 1673 1;
BA_ "DiagUudtResponse" BO_ 1673 1;
BA_ "MsgType" BO_ 1673 2;
BA_ "DiagResponse" BO_ 1673 1;
BA_ "VFrameFormat" BO_ 1673 14;
BA_ "GenMsgSendType" BO_ 1674 1;
BA_ "DiagUudtResponse" BO_ 1674 1;
BA_ "MsgType" BO_ 1674 2;
BA_ "DiagRequest" BO_ 1674 1;
BA_ "VFrameFormat" BO_ 1674 14;
BA_ "GenMsgSendType" BO_ 1675 1;
BA_ "DiagUudtResponse" BO_ 1675 1;
BA_ "MsgType" BO_ 1675 2;
BA_ "DiagResponse" BO_ 1675 1;
BA_ "VFrameFormat" BO_ 1675 14;
BA_ "GenMsgSendType" BO_ 1676 1;
BA_ "DiagUudtResponse" BO_ 1676 1;
BA_ "MsgType" BO_ 1676 2;
BA_ "DiagRequest" BO_ 1676 1;
BA_ "VFrameFormat" BO_ 1676 14;
BA_ "GenMsgSendType" BO_ 1677 1;
BA_ "DiagUudtResponse" BO_ 1677 1;
BA_ "MsgType" BO_ 1677 2;
BA_ "DiagResponse" BO_ 1677 1;
BA_ "VFrameFormat" BO_ 1677 14;
BA_ "GenMsgSendType" BO_ 1678 1;
BA_ "DiagUudtResponse" BO_ 1678 1;
BA_ "MsgType" BO_ 1678 2;
BA_ "DiagRequest" BO_ 1678 1;
BA_ "VFrameFormat" BO_ 1678 14;
BA_ "GenMsgSendType" BO_ 1679 1;
BA_ "DiagUudtResponse" BO_ 1679 1;
BA_ "MsgType" BO_ 1679 2;
BA_ "DiagResponse" BO_ 1679 1;
BA_ "VFrameFormat" BO_ 1679 14;
BA_ "GenMsgSendType" BO_ 1680 1;
BA_ "MsgType" BO_ 1680 2;
BA_ "VFrameFormat" BO_ 1680 14;
BA_ "GenMsgSendType" BO_ 1681 1;
BA_ "MsgType" BO_ 1681 2;
BA_ "VFrameFormat" BO_ 1681 14;
BA_ "GenMsgSendType" BO_ 1692 1;
BA_ "MsgType" BO_ 1692 2;
BA_ "VFrameFormat" BO_ 1692 14;
BA_ "GenMsgSendType" BO_ 1693 1;
BA_ "MsgType" BO_ 1693 2;
BA_ "VFrameFormat" BO_ 1693 14;
BA_ "GenMsgSendType" BO_ 1694 1;
BA_ "MsgType" BO_ 1694 2;
BA_ "VFrameFormat" BO_ 1694 14;
BA_ "GenMsgSendType" BO_ 1695 1;
BA_ "MsgType" BO_ 1695 2;
BA_ "VFrameFormat" BO_ 1695 14;
BA_ "GenMsgSendType" BO_ 1696 1;
BA_ "MsgType" BO_ 1696 2;
BA_ "VFrameFormat" BO_ 1696 14;
BA_ "GenMsgSendType" BO_ 1697 1;
BA_ "MsgType" BO_ 1697 2;
BA_ "VFrameFormat" BO_ 1697 14;
BA_ "GenMsgSendType" BO_ 1698 1;
BA_ "MsgType" BO_ 1698 2;
BA_ "VFrameFormat" BO_ 1698 14;
BA_ "GenMsgSendType" BO_ 1699 1;
BA_ "MsgType" BO_ 1699 2;
BA_ "VFrameFormat" BO_ 1699 14;
BA_ "GenMsgSendType" BO_ 1702 1;
BA_ "MsgType" BO_ 1702 2;
BA_ "VFrameFormat" BO_ 1702 14;
BA_ "GenMsgSendType" BO_ 1703 1;
BA_ "MsgType" BO_ 1703 2;
BA_ "VFrameFormat" BO_ 1703 14;
BA_ "GenMsgSendType" BO_ 1704 1;
BA_ "MsgType" BO_ 1704 2;
BA_ "VFrameFormat" BO_ 1704 14;
BA_ "GenMsgSendType" BO_ 1705 1;
BA_ "MsgType" BO_ 1705 2;
BA_ "VFrameFormat" BO_ 1705 14;
BA_ "GenMsgSendType" BO_ 1706 1;
BA_ "MsgType" BO_ 1706 2;
BA_ "VFrameFormat" BO_ 1706 14;
BA_ "GenMsgSendType" BO_ 1707 1;
BA_ "MsgType" BO_ 1707 2;
BA_ "VFrameFormat" BO_ 1707 14;
BA_ "GenMsgSendType" BO_ 1708 1;
BA_ "MsgType" BO_ 1708 2;
BA_ "VFrameFormat" BO_ 1708 14;
BA_ "GenMsgSendType" BO_ 1709 1;
BA_ "MsgType" BO_ 1709 2;
BA_ "VFrameFormat" BO_ 1709 14;
BA_ "GenMsgSendType" BO_ 1720 1;
BA_ "MsgType" BO_ 1720 2;
BA_ "VFrameFormat" BO_ 1720 14;
BA_ "GenMsgSendType" BO_ 1721 1;
BA_ "MsgType" BO_ 1721 2;
BA_ "VFrameFormat" BO_ 1721 14;
BA_ "GenMsgSendType" BO_ 1750 1;
BA_ "MsgType" BO_ 1750 2;
BA_ "VFrameFormat" BO_ 1750 14;
BA_ "GenMsgSendType" BO_ 1751 1;
BA_ "MsgType" BO_ 1751 2;
BA_ "VFrameFormat" BO_ 1751 14;
BA_ "GenMsgSendType" BO_ 1794 1;
BA_ "MsgType" BO_ 1794 2;
BA_ "VFrameFormat" BO_ 1794 14;
BA_ "GenMsgSendType" BO_ 1800 1;
BA_ "MsgType" BO_ 1800 2;
BA_ "VFrameFormat" BO_ 1800 14;
BA_ "GenMsgSendType" BO_ 1805 1;
BA_ "DiagUudtResponse" BO_ 1805 1;
BA_ "MsgType" BO_ 1805 2;
BA_ "DiagRequest" BO_ 1805 1;
BA_ "VFrameFormat" BO_ 1805 14;
BA_ "GenMsgSendType" BO_ 1810 1;
BA_ "DiagUudtResponse" BO_ 1810 1;
BA_ "MsgType" BO_ 1810 2;
BA_ "DiagRequest" BO_ 1810 1;
BA_ "VFrameFormat" BO_ 1810 14;
BA_ "GenMsgSendType" BO_ 1811 1;
BA_ "DiagUudtResponse" BO_ 1811 1;
BA_ "MsgType" BO_ 1811 2;
BA_ "DiagRequest" BO_ 1811 1;
BA_ "VFrameFormat" BO_ 1811 14;
BA_ "GenMsgSendType" BO_ 1814 1;
BA_ "DiagUudtResponse" BO_ 1814 1;
BA_ "MsgType" BO_ 1814 2;
BA_ "DiagRequest" BO_ 1814 1;
BA_ "VFrameFormat" BO_ 1814 14;
BA_ "GenMsgSendType" BO_ 1817 1;
BA_ "DiagUudtResponse" BO_ 1817 1;
BA_ "MsgType" BO_ 1817 2;
BA_ "DiagRequest" BO_ 1817 1;
BA_ "VFrameFormat" BO_ 1817 14;
BA_ "GenMsgSendType" BO_ 1818 1;
BA_ "DiagUudtResponse" BO_ 1818 1;
BA_ "MsgType" BO_ 1818 2;
BA_ "DiagRequest" BO_ 1818 1;
BA_ "VFrameFormat" BO_ 1818 14;
BA_ "GenMsgSendType" BO_ 1824 1;
BA_ "DiagUudtResponse" BO_ 1824 1;
BA_ "MsgType" BO_ 1824 2;
BA_ "DiagRequest" BO_ 1824 1;
BA_ "VFrameFormat" BO_ 1824 14;
BA_ "GenMsgSendType" BO_ 1825 1;
BA_ "DiagUudtResponse" BO_ 1825 1;
BA_ "MsgType" BO_ 1825 2;
BA_ "DiagRequest" BO_ 1825 1;
BA_ "VFrameFormat" BO_ 1825 14;
BA_ "GenMsgSendType" BO_ 1827 1;
BA_ "DiagUudtResponse" BO_ 1827 1;
BA_ "MsgType" BO_ 1827 2;
BA_ "DiagRequest" BO_ 1827 1;
BA_ "VFrameFormat" BO_ 1827 14;
BA_ "GenMsgSendType" BO_ 1829 1;
BA_ "DiagUudtResponse" BO_ 1829 1;
BA_ "MsgType" BO_ 1829 2;
BA_ "DiagRequest" BO_ 1829 1;
BA_ "VFrameFormat" BO_ 1829 14;
BA_ "GenMsgSendType" BO_ 1830 1;
BA_ "DiagUudtResponse" BO_ 1830 1;
BA_ "MsgType" BO_ 1830 2;
BA_ "DiagRequest" BO_ 1830 1;
BA_ "VFrameFormat" BO_ 1830 14;
BA_ "GenMsgSendType" BO_ 1832 1;
BA_ "MsgType" BO_ 1832 2;
BA_ "DiagRequest" BO_ 1832 1;
BA_ "DiagUudtResponse" BO_ 1832 1;
BA_ "VFrameFormat" BO_ 1832 14;
BA_ "GenMsgSendType" BO_ 1834 1;
BA_ "DiagUudtResponse" BO_ 1834 1;
BA_ "MsgType" BO_ 1834 2;
BA_ "DiagRequest" BO_ 1834 1;
BA_ "VFrameFormat" BO_ 1834 14;
BA_ "GenMsgSendType" BO_ 1835 1;
BA_ "DiagUudtResponse" BO_ 1835 1;
BA_ "MsgType" BO_ 1835 2;
BA_ "DiagRequest" BO_ 1835 1;
BA_ "VFrameFormat" BO_ 1835 14;
BA_ "GenMsgSendType" BO_ 1838 1;
BA_ "MsgType" BO_ 1838 2;
BA_ "VFrameFormat" BO_ 1838 14;
BA_ "GenMsgSendType" BO_ 1840 1;
BA_ "DiagUudtResponse" BO_ 1840 1;
BA_ "MsgType" BO_ 1840 2;
BA_ "DiagRequest" BO_ 1840 1;
BA_ "VFrameFormat" BO_ 1840 14;
BA_ "GenMsgSendType" BO_ 1841 1;
BA_ "DiagUudtResponse" BO_ 1841 1;
BA_ "MsgType" BO_ 1841 2;
BA_ "DiagRequest" BO_ 1841 1;
BA_ "VFrameFormat" BO_ 1841 14;
BA_ "GenMsgSendType" BO_ 1842 1;
BA_ "DiagUudtResponse" BO_ 1842 1;
BA_ "MsgType" BO_ 1842 2;
BA_ "DiagRequest" BO_ 1842 1;
BA_ "VFrameFormat" BO_ 1842 14;
BA_ "GenMsgSendType" BO_ 1843 1;
BA_ "MsgType" BO_ 1843 2;
BA_ "DiagRequest" BO_ 1843 1;
BA_ "DiagUudtResponse" BO_ 1843 1;
BA_ "VFrameFormat" BO_ 1843 14;
BA_ "GenMsgSendType" BO_ 1844 1;
BA_ "DiagUudtResponse" BO_ 1844 1;
BA_ "MsgType" BO_ 1844 2;
BA_ "DiagRequest" BO_ 1844 1;
BA_ "VFrameFormat" BO_ 1844 14;
BA_ "GenMsgSendType" BO_ 1845 1;
BA_ "DiagUudtResponse" BO_ 1845 1;
BA_ "MsgType" BO_ 1845 2;
BA_ "DiagRequest" BO_ 1845 1;
BA_ "VFrameFormat" BO_ 1845 14;
BA_ "GenMsgSendType" BO_ 1847 1;
BA_ "MsgType" BO_ 1847 2;
BA_ "DiagRequest" BO_ 1847 1;
BA_ "DiagUudtResponse" BO_ 1847 1;
BA_ "VFrameFormat" BO_ 1847 14;
BA_ "GenMsgSendType" BO_ 1848 1;
BA_ "MsgType" BO_ 1848 2;
BA_ "DiagRequest" BO_ 1848 1;
BA_ "DiagUudtResponse" BO_ 1848 1;
BA_ "VFrameFormat" BO_ 1848 14;
BA_ "GenMsgSendType" BO_ 1849 1;
BA_ "MsgType" BO_ 1849 2;
BA_ "DiagRequest" BO_ 1849 1;
BA_ "DiagUudtResponse" BO_ 1849 1;
BA_ "VFrameFormat" BO_ 1849 14;
BA_ "GenMsgSendType" BO_ 1851 1;
BA_ "MsgType" BO_ 1851 2;
BA_ "VFrameFormat" BO_ 1851 14;
BA_ "GenMsgSendType" BO_ 1853 1;
BA_ "DiagUudtResponse" BO_ 1853 1;
BA_ "MsgType" BO_ 1853 2;
BA_ "DiagRequest" BO_ 1853 1;
BA_ "VFrameFormat" BO_ 1853 14;
BA_ "GenMsgSendType" BO_ 1856 1;
BA_ "MsgType" BO_ 1856 2;
BA_ "VFrameFormat" BO_ 1856 14;
BA_ "GenMsgSendType" BO_ 1857 1;
BA_ "DiagUudtResponse" BO_ 1857 1;
BA_ "MsgType" BO_ 1857 2;
BA_ "DiagRequest" BO_ 1857 1;
BA_ "VFrameFormat" BO_ 1857 14;
BA_ "GenMsgSendType" BO_ 1858 1;
BA_ "DiagUudtResponse" BO_ 1858 1;
BA_ "MsgType" BO_ 1858 2;
BA_ "DiagRequest" BO_ 1858 1;
BA_ "VFrameFormat" BO_ 1858 14;
BA_ "GenMsgSendType" BO_ 1859 1;
BA_ "DiagUudtResponse" BO_ 1859 1;
BA_ "MsgType" BO_ 1859 2;
BA_ "DiagRequest" BO_ 1859 1;
BA_ "VFrameFormat" BO_ 1859 14;
BA_ "GenMsgSendType" BO_ 1860 1;
BA_ "DiagUudtResponse" BO_ 1860 1;
BA_ "MsgType" BO_ 1860 2;
BA_ "DiagRequest" BO_ 1860 1;
BA_ "VFrameFormat" BO_ 1860 14;
BA_ "GenMsgSendType" BO_ 1862 1;
BA_ "MsgType" BO_ 1862 2;
BA_ "DiagRequest" BO_ 1862 1;
BA_ "DiagUudtResponse" BO_ 1862 1;
BA_ "VFrameFormat" BO_ 1862 14;
BA_ "GenMsgSendType" BO_ 1868 1;
BA_ "DiagUudtResponse" BO_ 1868 1;
BA_ "MsgType" BO_ 1868 2;
BA_ "DiagRequest" BO_ 1868 1;
BA_ "VFrameFormat" BO_ 1868 14;
BA_ "GenMsgSendType" BO_ 1869 1;
BA_ "DiagUudtResponse" BO_ 1869 1;
BA_ "MsgType" BO_ 1869 2;
BA_ "DiagRequest" BO_ 1869 1;
BA_ "VFrameFormat" BO_ 1869 14;
BA_ "GenMsgSendType" BO_ 1871 1;
BA_ "DiagUudtResponse" BO_ 1871 1;
BA_ "MsgType" BO_ 1871 2;
BA_ "DiagRequest" BO_ 1871 1;
BA_ "VFrameFormat" BO_ 1871 14;
BA_ "GenMsgSendType" BO_ 1873 1;
BA_ "MsgType" BO_ 1873 2;
BA_ "VFrameFormat" BO_ 1873 14;
BA_ "GenMsgSendType" BO_ 1875 1;
BA_ "DiagUudtResponse" BO_ 1875 1;
BA_ "MsgType" BO_ 1875 2;
BA_ "DiagRequest" BO_ 1875 1;
BA_ "VFrameFormat" BO_ 1875 14;
BA_ "GenMsgSendType" BO_ 1877 1;
BA_ "MsgType" BO_ 1877 2;
BA_ "VFrameFormat" BO_ 1877 14;
BA_ "GenMsgSendType" BO_ 1878 1;
BA_ "DiagUudtResponse" BO_ 1878 1;
BA_ "MsgType" BO_ 1878 2;
BA_ "DiagRequest" BO_ 1878 1;
BA_ "VFrameFormat" BO_ 1878 14;
BA_ "GenMsgSendType" BO_ 1880 1;
BA_ "DiagUudtResponse" BO_ 1880 1;
BA_ "MsgType" BO_ 1880 2;
BA_ "DiagRequest" BO_ 1880 1;
BA_ "VFrameFormat" BO_ 1880 14;
BA_ "GenMsgSendType" BO_ 1889 1;
BA_ "MsgType" BO_ 1889 2;
BA_ "DiagRequest" BO_ 1889 1;
BA_ "DiagUudtResponse" BO_ 1889 1;
BA_ "VFrameFormat" BO_ 1889 14;
BA_ "GenMsgSendType" BO_ 1890 1;
BA_ "MsgType" BO_ 1890 2;
BA_ "VFrameFormat" BO_ 1890 14;
BA_ "GenMsgSendType" BO_ 1891 1;
BA_ "MsgType" BO_ 1891 2;
BA_ "DiagRequest" BO_ 1891 1;
BA_ "DiagUudtResponse" BO_ 1891 1;
BA_ "VFrameFormat" BO_ 1891 14;
BA_ "GenMsgSendType" BO_ 1894 1;
BA_ "MsgType" BO_ 1894 2;
BA_ "VFrameFormat" BO_ 1894 14;
BA_ "GenMsgSendType" BO_ 1896 1;
BA_ "MsgType" BO_ 1896 2;
BA_ "VFrameFormat" BO_ 1896 14;
BA_ "GenMsgSendType" BO_ 1897 1;
BA_ "DiagUudtResponse" BO_ 1897 1;
BA_ "MsgType" BO_ 1897 2;
BA_ "DiagResponse" BO_ 1897 1;
BA_ "VFrameFormat" BO_ 1897 14;
BA_ "GenMsgSendType" BO_ 1898 1;
BA_ "MsgType" BO_ 1898 2;
BA_ "VFrameFormat" BO_ 1898 14;
BA_ "GenMsgSendType" BO_ 1899 1;
BA_ "MsgType" BO_ 1899 2;
BA_ "DiagUudtResponse" BO_ 1899 1;
BA_ "DiagResponse" BO_ 1899 1;
BA_ "VFrameFormat" BO_ 1899 14;
BA_ "GenMsgSendType" BO_ 1900 1;
BA_ "DiagUudtResponse" BO_ 1900 1;
BA_ "MsgType" BO_ 1900 2;
BA_ "DiagRequest" BO_ 1900 1;
BA_ "VFrameFormat" BO_ 1900 14;
BA_ "GenMsgSendType" BO_ 1902 1;
BA_ "MsgType" BO_ 1902 2;
BA_ "VFrameFormat" BO_ 1902 14;
BA_ "GenMsgSendType" BO_ 1909 1;
BA_ "DiagUudtResponse" BO_ 1909 1;
BA_ "MsgType" BO_ 1909 2;
BA_ "DiagRequest" BO_ 1909 1;
BA_ "VFrameFormat" BO_ 1909 14;
BA_ "GenMsgSendType" BO_ 1912 1;
BA_ "MsgType" BO_ 1912 2;
BA_ "VFrameFormat" BO_ 1912 14;
BA_ "GenMsgSendType" BO_ 1916 1;
BA_ "DiagUudtResponse" BO_ 1916 1;
BA_ "MsgType" BO_ 1916 2;
BA_ "DiagResponse" BO_ 1916 1;
BA_ "VFrameFormat" BO_ 1916 14;
BA_ "GenMsgSendType" BO_ 1917 1;
BA_ "DiagUudtResponse" BO_ 1917 1;
BA_ "MsgType" BO_ 1917 2;
BA_ "DiagResponse" BO_ 1917 1;
BA_ "VFrameFormat" BO_ 1917 14;
BA_ "GenMsgSendType" BO_ 1922 1;
BA_ "MsgType" BO_ 1922 2;
BA_ "VFrameFormat" BO_ 1922 14;
BA_ "GenMsgSendType" BO_ 1928 1;
BA_ "MsgType" BO_ 1928 2;
BA_ "VFrameFormat" BO_ 1928 14;
BA_ "GenMsgSendType" BO_ 1933 1;
BA_ "DiagUudtResponse" BO_ 1933 1;
BA_ "MsgType" BO_ 1933 2;
BA_ "DiagResponse" BO_ 1933 1;
BA_ "VFrameFormat" BO_ 1933 14;
BA_ "GenMsgSendType" BO_ 1938 1;
BA_ "DiagUudtResponse" BO_ 1938 1;
BA_ "MsgType" BO_ 1938 2;
BA_ "DiagResponse" BO_ 1938 1;
BA_ "VFrameFormat" BO_ 1938 14;
BA_ "GenMsgSendType" BO_ 1939 1;
BA_ "DiagUudtResponse" BO_ 1939 1;
BA_ "MsgType" BO_ 1939 2;
BA_ "DiagResponse" BO_ 1939 1;
BA_ "VFrameFormat" BO_ 1939 14;
BA_ "GenMsgSendType" BO_ 1942 1;
BA_ "DiagUudtResponse" BO_ 1942 1;
BA_ "MsgType" BO_ 1942 2;
BA_ "DiagResponse" BO_ 1942 1;
BA_ "VFrameFormat" BO_ 1942 14;
BA_ "GenMsgSendType" BO_ 1945 1;
BA_ "DiagUudtResponse" BO_ 1945 1;
BA_ "MsgType" BO_ 1945 2;
BA_ "DiagResponse" BO_ 1945 1;
BA_ "VFrameFormat" BO_ 1945 14;
BA_ "GenMsgSendType" BO_ 1946 1;
BA_ "DiagUudtResponse" BO_ 1946 1;
BA_ "MsgType" BO_ 1946 2;
BA_ "DiagResponse" BO_ 1946 1;
BA_ "VFrameFormat" BO_ 1946 14;
BA_ "GenMsgSendType" BO_ 1952 1;
BA_ "DiagUudtResponse" BO_ 1952 1;
BA_ "MsgType" BO_ 1952 2;
BA_ "DiagResponse" BO_ 1952 1;
BA_ "VFrameFormat" BO_ 1952 14;
BA_ "GenMsgSendType" BO_ 1953 1;
BA_ "DiagUudtResponse" BO_ 1953 1;
BA_ "MsgType" BO_ 1953 2;
BA_ "DiagResponse" BO_ 1953 1;
BA_ "VFrameFormat" BO_ 1953 14;
BA_ "GenMsgSendType" BO_ 1955 1;
BA_ "DiagUudtResponse" BO_ 1955 1;
BA_ "MsgType" BO_ 1955 2;
BA_ "DiagResponse" BO_ 1955 1;
BA_ "VFrameFormat" BO_ 1955 14;
BA_ "GenMsgSendType" BO_ 1957 1;
BA_ "DiagUudtResponse" BO_ 1957 1;
BA_ "MsgType" BO_ 1957 2;
BA_ "DiagResponse" BO_ 1957 1;
BA_ "VFrameFormat" BO_ 1957 14;
BA_ "GenMsgSendType" BO_ 1958 1;
BA_ "DiagUudtResponse" BO_ 1958 1;
BA_ "MsgType" BO_ 1958 2;
BA_ "DiagResponse" BO_ 1958 1;
BA_ "VFrameFormat" BO_ 1958 14;
BA_ "GenMsgSendType" BO_ 1960 1;
BA_ "DiagUudtResponse" BO_ 1960 1;
BA_ "MsgType" BO_ 1960 2;
BA_ "DiagResponse" BO_ 1960 1;
BA_ "VFrameFormat" BO_ 1960 14;
BA_ "GenMsgSendType" BO_ 1962 1;
BA_ "DiagUudtResponse" BO_ 1962 1;
BA_ "MsgType" BO_ 1962 2;
BA_ "DiagResponse" BO_ 1962 1;
BA_ "VFrameFormat" BO_ 1962 14;
BA_ "GenMsgSendType" BO_ 1963 1;
BA_ "DiagUudtResponse" BO_ 1963 1;
BA_ "MsgType" BO_ 1963 2;
BA_ "DiagResponse" BO_ 1963 1;
BA_ "VFrameFormat" BO_ 1963 14;
BA_ "GenMsgSendType" BO_ 1966 1;
BA_ "MsgType" BO_ 1966 2;
BA_ "VFrameFormat" BO_ 1966 14;
BA_ "GenMsgSendType" BO_ 1968 1;
BA_ "DiagUudtResponse" BO_ 1968 1;
BA_ "MsgType" BO_ 1968 2;
BA_ "DiagResponse" BO_ 1968 1;
BA_ "VFrameFormat" BO_ 1968 14;
BA_ "GenMsgSendType" BO_ 1969 1;
BA_ "DiagUudtResponse" BO_ 1969 1;
BA_ "MsgType" BO_ 1969 2;
BA_ "DiagResponse" BO_ 1969 1;
BA_ "VFrameFormat" BO_ 1969 14;
BA_ "GenMsgSendType" BO_ 1970 1;
BA_ "DiagUudtResponse" BO_ 1970 1;
BA_ "MsgType" BO_ 1970 2;
BA_ "DiagResponse" BO_ 1970 1;
BA_ "VFrameFormat" BO_ 1970 14;
BA_ "GenMsgSendType" BO_ 1971 1;
BA_ "DiagUudtResponse" BO_ 1971 1;
BA_ "MsgType" BO_ 1971 2;
BA_ "DiagResponse" BO_ 1971 1;
BA_ "VFrameFormat" BO_ 1971 14;
BA_ "GenMsgSendType" BO_ 1972 1;
BA_ "DiagUudtResponse" BO_ 1972 1;
BA_ "MsgType" BO_ 1972 2;
BA_ "DiagResponse" BO_ 1972 1;
BA_ "VFrameFormat" BO_ 1972 14;
BA_ "GenMsgSendType" BO_ 1973 1;
BA_ "DiagUudtResponse" BO_ 1973 1;
BA_ "MsgType" BO_ 1973 2;
BA_ "DiagResponse" BO_ 1973 1;
BA_ "VFrameFormat" BO_ 1973 14;
BA_ "GenMsgSendType" BO_ 1975 1;
BA_ "DiagUudtResponse" BO_ 1975 1;
BA_ "MsgType" BO_ 1975 2;
BA_ "DiagResponse" BO_ 1975 1;
BA_ "VFrameFormat" BO_ 1975 14;
BA_ "GenMsgSendType" BO_ 1976 1;
BA_ "DiagUudtResponse" BO_ 1976 1;
BA_ "MsgType" BO_ 1976 2;
BA_ "DiagResponse" BO_ 1976 1;
BA_ "VFrameFormat" BO_ 1976 14;
BA_ "GenMsgSendType" BO_ 1977 1;
BA_ "DiagUudtResponse" BO_ 1977 1;
BA_ "MsgType" BO_ 1977 2;
BA_ "DiagResponse" BO_ 1977 1;
BA_ "VFrameFormat" BO_ 1977 14;
BA_ "GenMsgSendType" BO_ 1979 1;
BA_ "MsgType" BO_ 1979 2;
BA_ "VFrameFormat" BO_ 1979 14;
BA_ "GenMsgSendType" BO_ 1981 1;
BA_ "DiagUudtResponse" BO_ 1981 1;
BA_ "MsgType" BO_ 1981 2;
BA_ "DiagResponse" BO_ 1981 1;
BA_ "VFrameFormat" BO_ 1981 14;
BA_ "GenMsgSendType" BO_ 1984 1;
BA_ "MsgType" BO_ 1984 2;
BA_ "VFrameFormat" BO_ 1984 14;
BA_ "GenMsgSendType" BO_ 1985 1;
BA_ "MsgType" BO_ 1985 2;
BA_ "DiagUudtResponse" BO_ 1985 1;
BA_ "DiagResponse" BO_ 1985 1;
BA_ "VFrameFormat" BO_ 1985 14;
BA_ "GenMsgSendType" BO_ 1986 1;
BA_ "DiagUudtResponse" BO_ 1986 1;
BA_ "MsgType" BO_ 1986 2;
BA_ "DiagResponse" BO_ 1986 1;
BA_ "VFrameFormat" BO_ 1986 14;
BA_ "GenMsgSendType" BO_ 1987 1;
BA_ "MsgType" BO_ 1987 2;
BA_ "DiagUudtResponse" BO_ 1987 1;
BA_ "DiagResponse" BO_ 1987 1;
BA_ "VFrameFormat" BO_ 1987 14;
BA_ "GenMsgSendType" BO_ 1988 1;
BA_ "MsgType" BO_ 1988 2;
BA_ "DiagUudtResponse" BO_ 1988 1;
BA_ "DiagResponse" BO_ 1988 1;
BA_ "VFrameFormat" BO_ 1988 14;
BA_ "GenMsgSendType" BO_ 1990 1;
BA_ "MsgType" BO_ 1990 2;
BA_ "DiagUudtResponse" BO_ 1990 1;
BA_ "DiagResponse" BO_ 1990 1;
BA_ "VFrameFormat" BO_ 1990 14;
BA_ "GenMsgSendType" BO_ 1996 1;
BA_ "MsgType" BO_ 1996 2;
BA_ "DiagUudtResponse" BO_ 1996 1;
BA_ "DiagResponse" BO_ 1996 1;
BA_ "VFrameFormat" BO_ 1996 14;
BA_ "GenMsgSendType" BO_ 1997 1;
BA_ "MsgType" BO_ 1997 2;
BA_ "DiagUudtResponse" BO_ 1997 1;
BA_ "DiagResponse" BO_ 1997 1;
BA_ "VFrameFormat" BO_ 1997 14;
BA_ "GenMsgSendType" BO_ 1999 1;
BA_ "DiagUudtResponse" BO_ 1999 1;
BA_ "MsgType" BO_ 1999 2;
BA_ "DiagResponse" BO_ 1999 1;
BA_ "VFrameFormat" BO_ 1999 14;
BA_ "GenMsgSendType" BO_ 2001 1;
BA_ "MsgType" BO_ 2001 2;
BA_ "VFrameFormat" BO_ 2001 14;
BA_ "GenMsgSendType" BO_ 2003 1;
BA_ "DiagUudtResponse" BO_ 2003 1;
BA_ "MsgType" BO_ 2003 2;
BA_ "DiagResponse" BO_ 2003 1;
BA_ "VFrameFormat" BO_ 2003 14;
BA_ "GenMsgSendType" BO_ 2005 1;
BA_ "MsgType" BO_ 2005 2;
BA_ "VFrameFormat" BO_ 2005 14;
BA_ "GenMsgSendType" BO_ 2006 1;
BA_ "DiagUudtResponse" BO_ 2006 1;
BA_ "MsgType" BO_ 2006 2;
BA_ "DiagResponse" BO_ 2006 1;
BA_ "VFrameFormat" BO_ 2006 14;
BA_ "GenMsgSendType" BO_ 2008 1;
BA_ "DiagUudtResponse" BO_ 2008 1;
BA_ "MsgType" BO_ 2008 2;
BA_ "DiagResponse" BO_ 2008 1;
BA_ "VFrameFormat" BO_ 2008 14;
BA_ "GenMsgSendType" BO_ 2015 1;
BA_ "MsgType" BO_ 2015 2;
BA_ "DiagRequest" BO_ 2015 1;
BA_ "DiagUudtResponse" BO_ 2015 1;
BA_ "DiagState" BO_ 2015 1;
BA_ "VFrameFormat" BO_ 2015 14;
BA_ "GenMsgSendType" BO_ 2016 1;
BA_ "DiagUudtResponse" BO_ 2016 1;
BA_ "MsgType" BO_ 2016 2;
BA_ "DiagRequest" BO_ 2016 1;
BA_ "VFrameFormat" BO_ 2016 14;
BA_ "GenMsgSendType" BO_ 2017 1;
BA_ "MsgType" BO_ 2017 2;
BA_ "DiagRequest" BO_ 2017 1;
BA_ "DiagUudtResponse" BO_ 2017 1;
BA_ "VFrameFormat" BO_ 2017 14;
BA_ "GenMsgSendType" BO_ 2018 1;
BA_ "MsgType" BO_ 2018 2;
BA_ "DiagRequest" BO_ 2018 1;
BA_ "DiagUudtResponse" BO_ 2018 1;
BA_ "VFrameFormat" BO_ 2018 14;
BA_ "GenMsgSendType" BO_ 2019 1;
BA_ "MsgType" BO_ 2019 2;
BA_ "DiagRequest" BO_ 2019 1;
BA_ "DiagUudtResponse" BO_ 2019 1;
BA_ "VFrameFormat" BO_ 2019 14;
BA_ "GenMsgSendType" BO_ 2020 1;
BA_ "MsgType" BO_ 2020 2;
BA_ "DiagRequest" BO_ 2020 1;
BA_ "DiagUudtResponse" BO_ 2020 1;
BA_ "VFrameFormat" BO_ 2020 14;
BA_ "GenMsgSendType" BO_ 2021 1;
BA_ "MsgType" BO_ 2021 2;
BA_ "DiagRequest" BO_ 2021 1;
BA_ "DiagUudtResponse" BO_ 2021 1;
BA_ "VFrameFormat" BO_ 2021 14;
BA_ "GenMsgSendType" BO_ 2022 1;
BA_ "MsgType" BO_ 2022 2;
BA_ "DiagRequest" BO_ 2022 1;
BA_ "DiagUudtResponse" BO_ 2022 1;
BA_ "VFrameFormat" BO_ 2022 14;
BA_ "GenMsgSendType" BO_ 2024 1;
BA_ "DiagUudtResponse" BO_ 2024 1;
BA_ "MsgType" BO_ 2024 2;
BA_ "DiagResponse" BO_ 2024 1;
BA_ "VFrameFormat" BO_ 2024 14;
BA_ "GenMsgSendType" BO_ 2025 1;
BA_ "MsgType" BO_ 2025 2;
BA_ "VFrameFormat" BO_ 2025 14;
BA_ "GenMsgSendType" BO_ 2026 1;
BA_ "DiagUudtResponse" BO_ 2026 1;
BA_ "MsgType" BO_ 2026 2;
BA_ "DiagResponse" BO_ 2026 1;
BA_ "VFrameFormat" BO_ 2026 14;
BA_ "GenMsgSendType" BO_ 2027 1;
BA_ "DiagUudtResponse" BO_ 2027 1;
BA_ "MsgType" BO_ 2027 2;
BA_ "DiagResponse" BO_ 2027 1;
BA_ "VFrameFormat" BO_ 2027 14;
BA_ "GenMsgSendType" BO_ 2028 1;
BA_ "DiagUudtResponse" BO_ 2028 1;
BA_ "MsgType" BO_ 2028 2;
BA_ "DiagResponse" BO_ 2028 1;
BA_ "VFrameFormat" BO_ 2028 14;
BA_ "GenMsgSendType" BO_ 2030 1;
BA_ "DiagUudtResponse" BO_ 2030 1;
BA_ "MsgType" BO_ 2030 2;
BA_ "DiagResponse" BO_ 2030 1;
BA_ "VFrameFormat" BO_ 2030 14;
BA_ "GenMsgSendType" BO_ 2033 1;
BA_ "DiagUudtResponse" BO_ 2033 1;
BA_ "MsgType" BO_ 2033 2;
BA_ "DiagRequest" BO_ 2033 1;
BA_ "VFrameFormat" BO_ 2033 14;
BA_ "GenMsgSendType" BO_ 2041 1;
BA_ "DiagUudtResponse" BO_ 2041 1;
BA_ "MsgType" BO_ 2041 2;
BA_ "DiagResponse" BO_ 2041 1;
BA_ "VFrameFormat" BO_ 2041 14;
BA_ "GenSigSendType" SG_ 1531 BMS_HvBattSoeActDisChaCyc 0;
BA_ "GenSigStartValue" SG_ 1531 BMS_HvBattSoeActDisChaCyc 65535;
BA_ "GenSigInvalidValue" SG_ 1531 BMS_HvBattSoeActDisChaCyc 65535;
BA_ "GenSigSendType" SG_ 1531 BMS_HvBattSoeActReChaCyc 0;
BA_ "GenSigStartValue" SG_ 1531 BMS_HvBattSoeActReChaCyc 65535;
BA_ "GenSigInvalidValue" SG_ 1531 BMS_HvBattSoeActReChaCyc 65535;
BA_ "GenSigSendType" SG_ 1531 BMS_HvBattRatedEnergy 0;
BA_ "GenSigStartValue" SG_ 1531 BMS_HvBattRatedEnergy 16382;
BA_ "GenSigInvalidValue" SG_ 1531 BMS_HvBattRatedEnergy 16383;
BA_ "GenSigSendType" SG_ 1531 BMS_HvBattRatedU 0;
BA_ "GenSigStartValue" SG_ 1531 BMS_HvBattRatedU 16382;
BA_ "GenSigInvalidValue" SG_ 1531 BMS_HvBattRatedU 16383;
BA_ "GenSigSendType" SG_ 1531 BMS_HvBattTypeCode 0;
BA_ "GenSigStartValue" SG_ 1531 BMS_HvBattTypeCode 255;
BA_ "GenSigSendType" SG_ 1531 BMS_HvBattManufcCode 0;
BA_ "GenSigInvalidValue" SG_ 1531 BMS_HvBattManufcCode 4294967295;
BA_ "GenSigSendType" SG_ 1531 BMS_HvBattTempSensorTotalNum 0;
BA_ "GenSigStartValue" SG_ 1531 BMS_HvBattTempSensorTotalNum 65535;
BA_ "GenSigInvalidValue" SG_ 1531 BMS_HvBattTempSensorTotalNum 65535;
BA_ "GenSigSendType" SG_ 1531 BMS_HvBattTempSensorTempMaxNum 0;
BA_ "GenSigStartValue" SG_ 1531 BMS_HvBattTempSensorTempMaxNum 255;
BA_ "GenSigInvalidValue" SG_ 1531 BMS_HvBattTempSensorTempMaxNum 255;
BA_ "GenSigSendType" SG_ 1531 BMS_HvBattTempSensorTempMinNum 0;
BA_ "GenSigStartValue" SG_ 1531 BMS_HvBattTempSensorTempMinNum 255;
BA_ "GenSigInvalidValue" SG_ 1531 BMS_HvBattTempSensorTempMinNum 255;
BA_ "GenSigSendType" SG_ 1531 BMS_HvBattTempMaxNum 0;
BA_ "GenSigStartValue" SG_ 1531 BMS_HvBattTempMaxNum 255;
BA_ "GenSigInvalidValue" SG_ 1531 BMS_HvBattTempMaxNum 255;
BA_ "GenSigSendType" SG_ 1531 BMS_HvBattTempMinNum 0;
BA_ "GenSigStartValue" SG_ 1531 BMS_HvBattTempMinNum 255;
BA_ "GenSigInvalidValue" SG_ 1531 BMS_HvBattTempMinNum 255;
BA_ "GenSigSendType" SG_ 1531 BMS_BattCellTotalNum 0;
BA_ "GenSigStartValue" SG_ 1531 BMS_BattCellTotalNum 65535;
BA_ "GenSigInvalidValue" SG_ 1531 BMS_BattCellTotalNum 65535;
BA_ "GenSigSendType" SG_ 1531 BMS_HvBattVoltMaxNum 0;
BA_ "GenSigStartValue" SG_ 1531 BMS_HvBattVoltMaxNum 255;
BA_ "GenSigInvalidValue" SG_ 1531 BMS_HvBattVoltMaxNum 255;
BA_ "GenSigSendType" SG_ 1531 BMS_HvBattVoltMinNum 0;
BA_ "GenSigStartValue" SG_ 1531 BMS_HvBattVoltMinNum 255;
BA_ "GenSigInvalidValue" SG_ 1531 BMS_HvBattVoltMinNum 255;
BA_ "GenSigSendType" SG_ 1531 BMS_ActualSOCMin 0;
BA_ "GenSigStartValue" SG_ 1531 BMS_ActualSOCMin 4095;
BA_ "GenSigInvalidValue" SG_ 1531 BMS_ActualSOCMin 4095;
BA_ "GenSigSendType" SG_ 1531 BMS_ActualSOCMax 0;
BA_ "GenSigStartValue" SG_ 1531 BMS_ActualSOCMax 4095;
BA_ "GenSigInvalidValue" SG_ 1531 BMS_ActualSOCMax 4095;
BA_ "GenSigSendType" SG_ 1560 srcNodeID_ICC 0;
BA_ "GenSigStartValue" SG_ 1560 srcNodeID_ICC 24;
BA_ "GenSigSendType" SG_ 1560 RMR_ICC 0;
BA_ "GenSigSendType" SG_ 1560 NMm_ICC_Reserved1 0;
BA_ "GenSigSendType" SG_ 1560 ICC_Wakeup_Poweron 0;
BA_ "GenSigSendType" SG_ 1560 ICC_Wakeup_NM 0;
BA_ "GenSigSendType" SG_ 1560 ICC_Wakeup_Diag 0;
BA_ "GenSigSendType" SG_ 1560 ICC_Wakeup_PowerComfortable 0;
BA_ "GenSigSendType" SG_ 1560 ICC_Wakeup_HUD 0;
BA_ "GenSigSendType" SG_ 1560 ICC_Wakeup_EAMP 0;
BA_ "GenSigSendType" SG_ 1560 ICC_Awake_Poweron 0;
BA_ "GenSigSendType" SG_ 1560 ICC_Awake_NM 0;
BA_ "GenSigSendType" SG_ 1560 ICC_Awake_Diag 0;
BA_ "GenSigSendType" SG_ 1560 ICC_Awake_PowerComfortable 0;
BA_ "GenSigSendType" SG_ 1560 ICC_Awake_SentinelMode 0;
BA_ "GenSigSendType" SG_ 1560 ICC_Awake_PetMode 0;
BA_ "GenSigSendType" SG_ 1560 ICC_Awake_HUD 0;
BA_ "GenSigSendType" SG_ 1560 ICC_Awake_EAMP 0;
BA_ "GenSigSendType" SG_ 1560 ICC_Awake_FreezerFunction 0;
BA_ "GenSigSendType" SG_ 1560 ICC_Awake_PowerOffDelay 0;
BA_ "GenSigSendType" SG_ 1560 ICC_Awake_VehLockDwnLoad_618h 0;
BA_ "GenSigSendType" SG_ 1672 Diag_SBOX_REQ 1;
BA_ "GenSigSendType" SG_ 1673 Diag_SBOX_RES 1;
BA_ "GenSigSendType" SG_ 1674 Diag_ILCF_REQ 1;
BA_ "GenSigSendType" SG_ 1675 Diag_ILCF_RES 1;
BA_ "GenSigSendType" SG_ 1676 Diag_BBCM_REQ 1;
BA_ "GenSigSendType" SG_ 1677 Diag_BBCM_RES 1;
BA_ "GenSigSendType" SG_ 1678 Diag_CMSM_REQ 1;
BA_ "GenSigSendType" SG_ 1679 Diag_CMSM_RES 1;
BA_ "GenSigSendType" SG_ 1680 Diag_FLCCP_REQ 1;
BA_ "GenSigSendType" SG_ 1681 Diag_FLCCP_RES 1;
BA_ "GenSigSendType" SG_ 1692 Diag_FRCCP_REQ 1;
BA_ "GenSigSendType" SG_ 1693 Diag_FRCCP_RES 1;
BA_ "GenSigSendType" SG_ 1694 Diag_ATCM_REQ 1;
BA_ "GenSigSendType" SG_ 1695 Diag_ATCM_RES 1;
BA_ "GenSigSendType" SG_ 1696 Diag_DWDM_REQ 1;
BA_ "GenSigSendType" SG_ 1697 Diag_DWDM_RES 1;
BA_ "GenSigSendType" SG_ 1698 Diag_UVC_REQ 1;
BA_ "GenSigSendType" SG_ 1699 Diag_UVC_RES 1;
BA_ "GenSigSendType" SG_ 1702 Diag_APTC_REQ 1;
BA_ "GenSigSendType" SG_ 1703 Diag_APTC_RES 1;
BA_ "GenSigSendType" SG_ 1704 Diag_ECALL_REQ 1;
BA_ "GenSigSendType" SG_ 1705 Diag_ECALL_RES 1;
BA_ "GenSigSendType" SG_ 1706 Diag_PM25_REQ 1;
BA_ "GenSigSendType" SG_ 1707 Diag_PM25_RES 1;
BA_ "GenSigSendType" SG_ 1708 Diag_TCU_REQ 1;
BA_ "GenSigSendType" SG_ 1709 Diag_TCU_RES 1;
BA_ "GenSigSendType" SG_ 1720 Diag_EOP_REQ 1;
BA_ "GenSigSendType" SG_ 1721 Diag_EOP_RES 1;
BA_ "GenSigSendType" SG_ 1750 Diag_AIPMR_REQ 1;
BA_ "GenSigSendType" SG_ 1751 Diag_AIPMR_RES 1;
BA_ "GenSigSendType" SG_ 1794 Diag_IOC_REQ 1;
BA_ "GenSigSendType" SG_ 1800 Diag_RADAR_REQ 1;
BA_ "GenSigSendType" SG_ 1805 Diag_CWC_REQ 1;
BA_ "GenSigSendType" SG_ 1810 Diag_FMCU_REQ 1;
BA_ "GenSigSendType" SG_ 1811 Diag_BMS_REQ 1;
BA_ "GenSigSendType" SG_ 1814 Diag_EAC_REQ 1;
BA_ "GenSigSendType" SG_ 1817 Diag_EPC_REQ 1;
BA_ "GenSigSendType" SG_ 1818 Diag_RMCU_REQ 1;
BA_ "GenSigSendType" SG_ 1824 Diag_LISD_REQ 1;
BA_ "GenSigSendType" SG_ 1825 Diag_DCB_REQ 1;
BA_ "GenSigSendType" SG_ 1827 Diag_EPS_REQ 1;
BA_ "GenSigSendType" SG_ 1829 Diag_ICC_REQ 1;
BA_ "GenSigSendType" SG_ 1830 Diag_RISD_REQ 1;
BA_ "GenSigSendType" SG_ 1832 Diag_TBOX_REQ 1;
BA_ "GenSigSendType" SG_ 1834 Diag_ONEBOX_REQ_72Ah 1;
BA_ "GenSigSendType" SG_ 1835 Diag_ASU_REQ 1;
BA_ "GenSigSendType" SG_ 1838 Diag_PPMID_REQ 1;
BA_ "GenSigSendType" SG_ 1840 Diag_BNCM_REQ 1;
BA_ "GenSigSendType" SG_ 1841 Diag_LC_REQ 1;
BA_ "GenSigSendType" SG_ 1842 Diag_IPB2_REQ 1;
BA_ "GenSigSendType" SG_ 1843 Diag_TCUR_REQ 1;
BA_ "GenSigSendType" SG_ 1844 Diag_FLZCU_REQ 1;
BA_ "GenSigSendType" SG_ 1845 Diag_FRZCU_REQ 1;
BA_ "GenSigSendType" SG_ 1847 Diag_ADCC_REQ_737h 1;
BA_ "GenSigSendType" SG_ 1848 Diag_LHM_REQ_738h 1;
BA_ "GenSigSendType" SG_ 1849 Diag_RHM_REQ_739h 1;
BA_ "GenSigSendType" SG_ 1851 Diag_TCM_REQ 1;
BA_ "GenSigSendType" SG_ 1853 Diag_CDU_REQ 1;
BA_ "GenSigSendType" SG_ 1856 Diag_BSCU_REQ 1;
BA_ "GenSigSendType" SG_ 1857 Diag_FRM_REQ 1;
BA_ "GenSigSendType" SG_ 1858 Diag_FCM_REQ 1;
BA_ "GenSigSendType" SG_ 1859 Diag_RLCR_REQ 1;
BA_ "GenSigSendType" SG_ 1860 Diag_RRCR_REQ 1;
BA_ "GenSigSendType" SG_ 1862 Diag_SCU_REQ 1;
BA_ "GenSigSendType" SG_ 1868 Diag_FLCR_REQ 1;
BA_ "GenSigSendType" SG_ 1869 Diag_FRCR_REQ 1;
BA_ "GenSigSendType" SG_ 1871 Diag_EAMP_REQ 1;
BA_ "GenSigSendType" SG_ 1873 Diag_WPTC_REQ 1;
BA_ "GenSigSendType" SG_ 1875 Diag_EVCC_REQ 1;
BA_ "GenSigSendType" SG_ 1877 Diag_MFS_REQ 1;
BA_ "GenSigSendType" SG_ 1878 Diag_CWCR_REQ 1;
BA_ "GenSigSendType" SG_ 1880 Diag_CSA_REQ 1;
BA_ "GenSigSendType" SG_ 1889 Diag_DDMA_REQ 1;
BA_ "GenSigSendType" SG_ 1890 Diag_TAIM_REQ 1;
BA_ "GenSigSendType" SG_ 1891 DIAG_AVAS_REQ 1;
BA_ "GenSigSendType" SG_ 1894 Diag_CHB_REQ 1;
BA_ "GenSigSendType" SG_ 1896 Diag_GLONASS_REQ 1;
BA_ "GenSigSendType" SG_ 1897 Diag_DDMA_RES 1;
BA_ "GenSigSendType" SG_ 1898 Diag_TAIM_RES 1;
BA_ "GenSigSendType" SG_ 1899 DIAG_AVAS_RES 1;
BA_ "GenSigSendType" SG_ 1900 Diag_PLG_REQ 1;
BA_ "GenSigSendType" SG_ 1902 Diag_CHB_RES 1;
BA_ "GenSigSendType" SG_ 1909 Diag_LBMS_REQ 1;
BA_ "GenSigSendType" SG_ 1912 Diag_GLONASS_RES 1;
BA_ "GenSigSendType" SG_ 1916 Diag_PLG_RES 1;
BA_ "GenSigSendType" SG_ 1917 Diag_LBMS_RES 1;
BA_ "GenSigSendType" SG_ 1922 Diag_IOC_RES 1;
BA_ "GenSigSendType" SG_ 1928 Diag_RADAR_RES 1;
BA_ "GenSigSendType" SG_ 1933 Diag_CWC_RES 1;
BA_ "GenSigSendType" SG_ 1938 Diag_FMCU_RES 1;
BA_ "GenSigSendType" SG_ 1939 Diag_BMS_RES 1;
BA_ "GenSigSendType" SG_ 1942 Diag_EAC_RES 1;
BA_ "GenSigSendType" SG_ 1945 Diag_EPC_RES 1;
BA_ "GenSigSendType" SG_ 1946 Diag_RMCU_RES 1;
BA_ "GenSigSendType" SG_ 1952 Diag_LISD_RES 1;
BA_ "GenSigSendType" SG_ 1953 Diag_DCB_RES 1;
BA_ "GenSigSendType" SG_ 1955 Diag_EPS_RES 1;
BA_ "GenSigSendType" SG_ 1957 Diag_ICC_RES 1;
BA_ "GenSigSendType" SG_ 1958 Diag_RISD_RES 1;
BA_ "GenSigSendType" SG_ 1960 Diag_TBOX_RES 1;
BA_ "GenSigSendType" SG_ 1962 Diag_ONEBOX_RES 1;
BA_ "GenSigSendType" SG_ 1963 Diag_ASU_RES 1;
BA_ "GenSigSendType" SG_ 1966 Diag_PPMID_RES 1;
BA_ "GenSigSendType" SG_ 1968 Diag_BNCM_RES 1;
BA_ "GenSigSendType" SG_ 1969 Diag_LC_RES 1;
BA_ "GenSigSendType" SG_ 1970 Diag_IPB2_RES 1;
BA_ "GenSigSendType" SG_ 1971 Diag_TCUR_RES 1;
BA_ "GenSigSendType" SG_ 1972 Diag_FLZCU_RES 1;
BA_ "GenSigSendType" SG_ 1973 Diag_FRZCU_RES 1;
BA_ "GenSigSendType" SG_ 1975 Diag_ADCC_RES_7B7h 1;
BA_ "GenSigSendType" SG_ 1976 Diag_LHM_RES_7B8h 1;
BA_ "GenSigSendType" SG_ 1977 Diag_RHM_RES_7B9h 1;
BA_ "GenSigSendType" SG_ 1979 Diag_TCM_RES 1;
BA_ "GenSigSendType" SG_ 1981 Diag_CDU_RES 1;
BA_ "GenSigSendType" SG_ 1984 Diag_BSCU_RES 1;
BA_ "GenSigSendType" SG_ 1985 Diag_FRM_RES 1;
BA_ "GenSigSendType" SG_ 1986 Diag_FCM_RES 1;
BA_ "GenSigSendType" SG_ 1987 Diag_RLCR_RES 1;
BA_ "GenSigSendType" SG_ 1988 Diag_RRCR_RES 1;
BA_ "GenSigSendType" SG_ 1990 Diag_SCU_RES 1;
BA_ "GenSigSendType" SG_ 1996 Diag_FLCR_RES 1;
BA_ "GenSigSendType" SG_ 1997 Diag_FRCR_RES 1;
BA_ "GenSigSendType" SG_ 1999 Diag_EAMP_RES 1;
BA_ "GenSigSendType" SG_ 2001 Diag_WPTC_RES 1;
BA_ "GenSigSendType" SG_ 2003 Diag_EVCC_RES 1;
BA_ "GenSigSendType" SG_ 2005 Diag_MFS_RES 1;
BA_ "GenSigSendType" SG_ 2006 Diag_CWCR_RES 1;
BA_ "GenSigSendType" SG_ 2008 Diag_CSA_RES 1;
BA_ "GenSigSendType" SG_ 2015 Diag_Functional_REQ 1;
BA_ "GenSigSendType" SG_ 2016 Diag_OBD_EMS_REQ 1;
BA_ "GenSigSendType" SG_ 2017 Diag_OBD_TCU_REQ 1;
BA_ "GenSigSendType" SG_ 2018 Diag_OBD_BMS_REQ 1;
BA_ "GenSigSendType" SG_ 2019 Diag_OBD_RMCU_REQ 1;
BA_ "GenSigSendType" SG_ 2020 Diag_OBD_ISG_REQ 1;
BA_ "GenSigSendType" SG_ 2021 Diag_ONEBOX_REQ 1;
BA_ "GenSigSendType" SG_ 2022 Diag_OBD_CDU_REQ 1;
BA_ "GenSigSendType" SG_ 2024 Diag_OBD_EMS_RES 1;
BA_ "GenSigSendType" SG_ 2025 Diag_OBD_TCU_RES 1;
BA_ "GenSigSendType" SG_ 2026 Diag_OBD_BMS_RES 1;
BA_ "GenSigSendType" SG_ 2027 Diag_OBD_RMCU_RES 1;
BA_ "GenSigSendType" SG_ 2028 Diag_OBD_ISG_RES 1;
BA_ "GenSigSendType" SG_ 2030 Diag_OBD_CDU_RES 1;
BA_ "GenSigSendType" SG_ 2033 Diag_ACU_REQ 1;
BA_ "GenSigSendType" SG_ 2041 Diag_ACU_RES 1;
VAL_ 1531 BMS_HvBattSoeActDisChaCyc 65534 "Abnormal" 65535 "Invalid" ;
VAL_ 1531 BMS_HvBattSoeActReChaCyc 65534 "Abnormal" 65535 "Invalid" ;
VAL_ 1531 BMS_HvBattRatedEnergy 16382 "Abnormal" 16383 "Invalid" ;
VAL_ 1531 BMS_HvBattRatedU 16382 "Abnormal" 16383 "Invalid" ;
VAL_ 1531 BMS_HvBattTypeCode 0 "reserved" 1 "LFP" 2 "LMO" 3 "LCO" 4 "NCM" 5 "Polymer Lithium ion" 6 "Supercapacitors" 7 "LTO" 252 "Fuel Cell" 255 "other type" ;
VAL_ 1531 BMS_HvBattManufcCode -2147483648 "Invalid" -2147483648 "Abnormal" ;
VAL_ 1531 BMS_HvBattTempSensorTempMaxNum 254 "Abnormal" 255 "Invalid" ;
VAL_ 1531 BMS_HvBattTempSensorTempMinNum 254 "Abnormal" 255 "Invalid" ;
VAL_ 1531 BMS_HvBattTempMaxNum 254 "Abnormal" 255 "Invalid" ;
VAL_ 1531 BMS_HvBattTempMinNum 254 "Abnormal" 255 "Invalid" ;
VAL_ 1531 BMS_BattCellTotalNum 65534 "Abnormal" 65535 "Invalid" ;
VAL_ 1531 BMS_HvBattVoltMaxNum 254 "Abnormal" 255 "Invalid" ;
VAL_ 1531 BMS_HvBattVoltMinNum 254 "Abnormal" 255 "Invalid" ;
VAL_ 1531 BMS_ActualSOCMin 4095 "Invalid" ;
VAL_ 1531 BMS_ActualSOCMax 4095 "Invalid" ;
VAL_ 1560 RMR_ICC 0 "Inactive" 1 "Active" ;
VAL_ 1560 ICC_Wakeup_Poweron 0 "Inactive" 1 "Active" ;
VAL_ 1560 ICC_Wakeup_NM 0 "Inactive" 1 "Active" ;
VAL_ 1560 ICC_Wakeup_Diag 0 "Inactive" 1 "Active" ;
VAL_ 1560 ICC_Wakeup_PowerComfortable 0 "Inactive" 1 "Active" ;
VAL_ 1560 ICC_Wakeup_HUD 0 "Inactive" 1 "Active" ;
VAL_ 1560 ICC_Wakeup_EAMP 0 "Inactive" 1 "Active" ;
VAL_ 1560 ICC_Awake_Poweron 0 "Inactive" 1 "Active" ;
VAL_ 1560 ICC_Awake_NM 0 "Inactive" 1 "Active" ;
VAL_ 1560 ICC_Awake_Diag 0 "Inactive" 1 "Active" ;
VAL_ 1560 ICC_Awake_PowerComfortable 0 "Inactive" 1 "Active" ;
VAL_ 1560 ICC_Awake_SentinelMode 0 "Inactive" 1 "Active" ;
VAL_ 1560 ICC_Awake_PetMode 0 "Inactive" 1 "Active" ;
VAL_ 1560 ICC_Awake_HUD 0 "Inactive" 1 "Active" ;
VAL_ 1560 ICC_Awake_EAMP 0 "Inactive" 1 "Active" ;
VAL_ 1560 ICC_Awake_FreezerFunction 0 "Inactive" 1 "Active" ;
VAL_ 1560 ICC_Awake_PowerOffDelay 0 "Inactive" 1 "Active" ;
VAL_ 1560 ICC_Awake_VehLockDwnLoad_618h 0 "Inactive" 1 "Active" ;
